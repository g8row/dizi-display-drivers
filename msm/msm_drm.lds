SECTIONS {
	__patchable_function_entries : { *(__patchable_function_entries) }
	.text : {
		msm_hdcp_register_cb.cfi_jt = . + 0x1b5260;
		msm_hdcp_cache_repeater_topology.cfi_jt = . + 0x1b5268;
		sde_rotator_inline_open.cfi_jt = . + 0x1b5270;
		sde_rotator_queue_init.cfi_jt = . + 0x1b5278;
		sde_rotator_s_ctrl.cfi_jt = . + 0x1b5280;
		sde_rotator_fs_show.cfi_jt = . + 0x1b5288;
		sde_rotator_fs_store.cfi_jt = . + 0x1b5290;
		sde_rotator_queue_setup.cfi_jt = . + 0x1b5298;
		sde_rotator_start_streaming.cfi_jt = . + 0x1b52a0;
		vb2_ops_wait_prepare.cfi_jt = . + 0x1b52a8;
		vb2_ops_wait_finish.cfi_jt = . + 0x1b52b0;
		sde_rotator_stop_streaming.cfi_jt = . + 0x1b52b8;
		sde_rotator_buf_finish.cfi_jt = . + 0x1b52c0;
		sde_rotator_buf_queue.cfi_jt = . + 0x1b52c8;
		sde_rotator_get_userptr.cfi_jt = . + 0x1b52d0;
		sde_rotator_inline_get_pixfmt_caps.cfi_jt = . + 0x1b52d8;
		sde_rotator_inline_get_dst_pixfmt.cfi_jt = . + 0x1b52e0;
		sde_rotator_inline_get_downscale_caps.cfi_jt = . + 0x1b52e8;
		sde_rotator_inline_commit.cfi_jt = . + 0x1b52f0;
		video_device_release.cfi_jt = . + 0x1b52f8;
		sde_rotator_querycap.cfi_jt = . + 0x1b5300;
		sde_rotator_enum_fmt_vid_cap.cfi_jt = . + 0x1b5308;
		sde_rotator_enum_fmt_vid_out.cfi_jt = . + 0x1b5310;
		sde_rotator_g_fmt_cap.cfi_jt = . + 0x1b5318;
		sde_rotator_g_fmt_out.cfi_jt = . + 0x1b5320;
		sde_rotator_s_fmt_vid_cap.cfi_jt = . + 0x1b5328;
		sde_rotator_s_fmt_vid_out.cfi_jt = . + 0x1b5330;
		sde_rotator_try_fmt_vid_cap.cfi_jt = . + 0x1b5338;
		sde_rotator_try_fmt_vid_out.cfi_jt = . + 0x1b5340;
		sde_rotator_reqbufs.cfi_jt = . + 0x1b5348;
		sde_rotator_querybuf.cfi_jt = . + 0x1b5350;
		sde_rotator_qbuf.cfi_jt = . + 0x1b5358;
		sde_rotator_dqbuf.cfi_jt = . + 0x1b5360;
		sde_rotator_streamon.cfi_jt = . + 0x1b5368;
		sde_rotator_streamoff.cfi_jt = . + 0x1b5370;
		sde_rotator_g_selection.cfi_jt = . + 0x1b5378;
		sde_rotator_s_selection.cfi_jt = . + 0x1b5380;
		sde_rotator_g_parm.cfi_jt = . + 0x1b5388;
		sde_rotator_s_parm.cfi_jt = . + 0x1b5390;
		sde_rotator_ctrl_subscribe_event.cfi_jt = . + 0x1b5398;
		sde_rotator_event_unsubscribe.cfi_jt = . + 0x1b53a0;
		sde_rotator_private_ioctl.cfi_jt = . + 0x1b53a8;
		sde_rotator_open.cfi_jt = . + 0x1b53b0;
		sde_rotator_release.cfi_jt = . + 0x1b53b8;
		trace_event_reg.cfi_jt = . + 0x1b53c0;
		trace_event_raw_init.cfi_jt = . + 0x1b53c8;
		__traceiter_rot_trace_counter.cfi_jt = . + 0x1b53d0;
		__traceiter_rot_perf_set_qos_luts.cfi_jt = . + 0x1b53d8;
		__traceiter_rot_perf_set_panic_luts.cfi_jt = . + 0x1b53e0;
		__traceiter_rot_perf_set_ot.cfi_jt = . + 0x1b53e8;
		__traceiter_rot_perf_prefill_calc.cfi_jt = . + 0x1b53f0;
		__traceiter_rot_mark_write.cfi_jt = . + 0x1b53f8;
		__traceiter_rot_entry_fence.cfi_jt = . + 0x1b5400;
		__traceiter_rot_entry_done.cfi_jt = . + 0x1b5408;
		__traceiter_rot_entry_commit.cfi_jt = . + 0x1b5410;
		trace_event_raw_event_rot_trace_counter.cfi_jt = . + 0x1b5418;
		perf_trace_rot_trace_counter.cfi_jt = . + 0x1b5420;
		__bpf_trace_rot_trace_counter.cfi_jt = . + 0x1b5428;
		trace_event_raw_event_rot_perf_set_qos_luts.cfi_jt = . + 0x1b5430;
		perf_trace_rot_perf_set_qos_luts.cfi_jt = . + 0x1b5438;
		__bpf_trace_rot_perf_set_qos_luts.cfi_jt = . + 0x1b5440;
		trace_event_raw_event_rot_perf_set_panic_luts.cfi_jt = . + 0x1b5448;
		perf_trace_rot_perf_set_panic_luts.cfi_jt = . + 0x1b5450;
		__bpf_trace_rot_perf_set_panic_luts.cfi_jt = . + 0x1b5458;
		trace_event_raw_event_rot_perf_set_ot.cfi_jt = . + 0x1b5460;
		perf_trace_rot_perf_set_ot.cfi_jt = . + 0x1b5468;
		__bpf_trace_rot_perf_set_ot.cfi_jt = . + 0x1b5470;
		trace_event_raw_event_rot_perf_prefill_calc.cfi_jt = . + 0x1b5478;
		perf_trace_rot_perf_prefill_calc.cfi_jt = . + 0x1b5480;
		__bpf_trace_rot_perf_prefill_calc.cfi_jt = . + 0x1b5488;
		trace_event_raw_event_rot_mark_write.cfi_jt = . + 0x1b5490;
		perf_trace_rot_mark_write.cfi_jt = . + 0x1b5498;
		__bpf_trace_rot_mark_write.cfi_jt = . + 0x1b54a0;
		trace_event_raw_event_rot_entry_template.cfi_jt = . + 0x1b54a8;
		perf_trace_rot_entry_template.cfi_jt = . + 0x1b54b0;
		__bpf_trace_rot_entry_template.cfi_jt = . + 0x1b54b8;
		sde_rot_dmabuf_map_tiny.cfi_jt = . + 0x1b54c0;
		sde_rot_dmabuf_unmap.cfi_jt = . + 0x1b54c8;
		sde_rot_dmabuf_release.cfi_jt = . + 0x1b54d0;
		sde_rot_dmabuf_no_mmap.cfi_jt = . + 0x1b54d8;
		sde_mdp_writeback_start.cfi_jt = . + 0x1b54e0;
		sde_mdp_writeback_stop.cfi_jt = . + 0x1b54e8;
		sde_mdp_writeback_prepare_rot.cfi_jt = . + 0x1b54f0;
		sde_mdp_writeback_display.cfi_jt = . + 0x1b54f8;
		sde_mdp_wb_wait4comp.cfi_jt = . + 0x1b5500;
		sde_hw_rotator_pre_pmevent.cfi_jt = . + 0x1b5508;
		sde_hw_rotator_post_pmevent.cfi_jt = . + 0x1b5510;
		sde_rotator_hw_alloc_ext.cfi_jt = . + 0x1b5518;
		sde_hw_rotator_alloc_ext.cfi_jt = . + 0x1b5520;
		sde_rotator_hw_free_ext.cfi_jt = . + 0x1b5528;
		sde_hw_rotator_free_ext.cfi_jt = . + 0x1b5530;
		sde_rotator_config_hw.cfi_jt = . + 0x1b5538;
		sde_rotator_cancel_hw.cfi_jt = . + 0x1b5540;
		sde_rotator_abort_hw.cfi_jt = . + 0x1b5548;
		sde_rotator_kickoff_entry.cfi_jt = . + 0x1b5550;
		sde_rotator_wait_for_entry.cfi_jt = . + 0x1b5558;
		sde_hw_rotator_config.cfi_jt = . + 0x1b5560;
		sde_hw_rotator_cancel.cfi_jt = . + 0x1b5568;
		sde_hw_rotator_abort_kickoff.cfi_jt = . + 0x1b5570;
		sde_hw_rotator_kickoff.cfi_jt = . + 0x1b5578;
		sde_hw_rotator_wait4done.cfi_jt = . + 0x1b5580;
		sde_rotator_hw_validate_entry.cfi_jt = . + 0x1b5588;
		sde_hw_rotator_validate_entry.cfi_jt = . + 0x1b5590;
		sde_rotator_hw_show_caps.cfi_jt = . + 0x1b5598;
		sde_rotator_hw_show_state.cfi_jt = . + 0x1b55a0;
		sde_hw_rotator_show_caps.cfi_jt = . + 0x1b55a8;
		sde_hw_rotator_show_state.cfi_jt = . + 0x1b55b0;
		sde_hw_rotator_get_pixfmt.cfi_jt = . + 0x1b55b8;
		sde_hw_rotator_get_pixfmt.636.cfi_jt = . + 0x1b55c0;
		sde_hw_rotator_is_valid_pixfmt.cfi_jt = . + 0x1b55c8;
		sde_hw_rotator_is_valid_pixfmt.637.cfi_jt = . + 0x1b55d0;
		sde_hw_rotator_get_downscale_caps.cfi_jt = . + 0x1b55d8;
		sde_rotator_r1_init.cfi_jt = . + 0x1b55e0;
		sde_rotator_r3_init.cfi_jt = . + 0x1b55e8;
		sde_hw_rotator_get_maxlinewidth.cfi_jt = . + 0x1b55f0;
		sde_rotator_hw_destroy.cfi_jt = . + 0x1b55f8;
		sde_hw_rotator_destroy.cfi_jt = . + 0x1b5600;
		sde_hw_rotator_dump_status.cfi_jt = . + 0x1b5608;
		sde_hw_rotator_setup_fetchengine.cfi_jt = . + 0x1b5610;
		sde_hw_rotator_setup_wbengine.cfi_jt = . + 0x1b5618;
		sde_hw_rotator_start_regdma.cfi_jt = . + 0x1b5620;
		sde_hw_rotator_start_no_regdma.cfi_jt = . + 0x1b5628;
		sde_hw_rotator_wait_done_regdma.cfi_jt = . + 0x1b5630;
		sde_hw_rotator_wait_done_no_regdma.cfi_jt = . + 0x1b5638;
		sde_hw_rotator_pending_swts.cfi_jt = . + 0x1b5640;
		sde_hw_rotator_pending_hwts.cfi_jt = . + 0x1b5648;
		sde_hw_rotator_update_swts.cfi_jt = . + 0x1b5650;
		sde_hw_rotator_update_hwts.cfi_jt = . + 0x1b5658;
		dma_fence_default_wait.cfi_jt = . + 0x1b5660;
		sde_vm_request_valid.cfi_jt = . + 0x1b5668;
		sde_vm_msg_send.cfi_jt = . + 0x1b5670;
		sde_vm_irq_release_notification_handler.cfi_jt = . + 0x1b5678;
		sde_vm_irq_lend_notification_handler.cfi_jt = . + 0x1b5680;
		sde_vm_post_acquire.cfi_jt = . + 0x1b5688;
		sde_vm_pre_release.cfi_jt = . + 0x1b5690;
		_sde_vm_release.cfi_jt = . + 0x1b5698;
		_sde_vm_reclaim.cfi_jt = . + 0x1b56a0;
		_sde_vm_release.790.cfi_jt = . + 0x1b56a8;
		_sde_vm_accept.cfi_jt = . + 0x1b56b0;
		_sde_vm_owns_hw.cfi_jt = . + 0x1b56b8;
		_sde_vm_owns_hw.791.cfi_jt = . + 0x1b56c0;
		_sde_vm_deinit.cfi_jt = . + 0x1b56c8;
		_sde_vm_deinit.792.cfi_jt = . + 0x1b56d0;
		sde_vm_mem_release_notification_handler.cfi_jt = . + 0x1b56d8;
		sde_vm_mem_lend_notification_handler.cfi_jt = . + 0x1b56e0;
		sde_rotator_r1_create_debugfs.cfi_jt = . + 0x1b56e8;
		sde_rotator_r3_create_debugfs.cfi_jt = . + 0x1b56f0;
		dp_altmode_notify.cfi_jt = . + 0x1b56f8;
		dp_parser_parse.cfi_jt = . + 0x1b5700;
		dp_parser_get_io.cfi_jt = . + 0x1b5708;
		dp_parser_get_io_buf.cfi_jt = . + 0x1b5710;
		dp_parser_clear_io_buf.cfi_jt = . + 0x1b5718;
		dp_power_init.cfi_jt = . + 0x1b5720;
		dp_power_clk_enable.cfi_jt = . + 0x1b5728;
		dp_power_clk_status.cfi_jt = . + 0x1b5730;
		dp_power_set_pixel_clk_parent.cfi_jt = . + 0x1b5738;
		dp_power_deinit.cfi_jt = . + 0x1b5740;
		dp_power_park_clocks.cfi_jt = . + 0x1b5748;
		dp_power_clk_get_rate.cfi_jt = . + 0x1b5750;
		dp_power_client_init.cfi_jt = . + 0x1b5758;
		dp_power_client_deinit.cfi_jt = . + 0x1b5760;
		dp_power_mmrm_init.cfi_jt = . + 0x1b5768;
		dp_catalog_set_exe_mode.cfi_jt = . + 0x1b5770;
		dp_catalog_reg_dump.cfi_jt = . + 0x1b5778;
		dp_read_hw.cfi_jt = . + 0x1b5780;
		dp_read_sw.cfi_jt = . + 0x1b5788;
		dp_write_hw.cfi_jt = . + 0x1b5790;
		dp_write_sw.cfi_jt = . + 0x1b5798;
		dp_read_sub_hw.cfi_jt = . + 0x1b57a0;
		dp_read_sub_sw.cfi_jt = . + 0x1b57a8;
		dp_write_sub_hw.cfi_jt = . + 0x1b57b0;
		dp_write_sub_sw.cfi_jt = . + 0x1b57b8;
		dp_catalog_panel_timing_cfg.cfi_jt = . + 0x1b57c0;
		dp_catalog_panel_config_hdr.cfi_jt = . + 0x1b57c8;
		dp_catalog_panel_set_colorspace.cfi_jt = . + 0x1b57d0;
		dp_catalog_panel_config_ctrl.cfi_jt = . + 0x1b57d8;
		dp_catalog_panel_config_sdp.cfi_jt = . + 0x1b57e0;
		dp_catalog_panel_tpg_cfg.cfi_jt = . + 0x1b57e8;
		dp_catalog_panel_config_dto.cfi_jt = . + 0x1b57f0;
		dp_catalog_panel_config_spd.cfi_jt = . + 0x1b57f8;
		dp_catalog_panel_config_misc.cfi_jt = . + 0x1b5800;
		dp_catalog_panel_update_transfer_unit.cfi_jt = . + 0x1b5808;
		dp_catalog_panel_dsc_cfg.cfi_jt = . + 0x1b5810;
		dp_catalog_panel_pps_flush.cfi_jt = . + 0x1b5818;
		dp_catalog_panel_dhdr_flush.cfi_jt = . + 0x1b5820;
		dp_catalog_panel_dhdr_busy.cfi_jt = . + 0x1b5828;
		dp_catalog_audio_init.cfi_jt = . + 0x1b5830;
		dp_catalog_audio_enable.cfi_jt = . + 0x1b5838;
		dp_catalog_audio_config_acr.cfi_jt = . + 0x1b5840;
		dp_catalog_audio_config_sdp.cfi_jt = . + 0x1b5848;
		dp_catalog_audio_set_header.cfi_jt = . + 0x1b5850;
		dp_catalog_audio_get_header.cfi_jt = . + 0x1b5858;
		dp_catalog_hpd_config_hpd.cfi_jt = . + 0x1b5860;
		dp_catalog_hpd_get_interrupt.cfi_jt = . + 0x1b5868;
		dp_catalog_ctrl_mainlink_ready.cfi_jt = . + 0x1b5870;
		dp_catalog_ctrl_state_ctrl.cfi_jt = . + 0x1b5878;
		dp_catalog_ctrl_set_pattern.cfi_jt = . + 0x1b5880;
		dp_catalog_ctrl_send_phy_pattern.cfi_jt = . + 0x1b5888;
		dp_catalog_ctrl_read_hdcp_status.cfi_jt = . + 0x1b5890;
		dp_catalog_ctrl_read_phy_pattern.cfi_jt = . + 0x1b5898;
		dp_catalog_ctrl_reset.cfi_jt = . + 0x1b58a0;
		dp_catalog_ctrl_phy_reset.cfi_jt = . + 0x1b58a8;
		dp_catalog_ctrl_get_interrupt.cfi_jt = . + 0x1b58b0;
		dp_catalog_ctrl_trigger_act.cfi_jt = . + 0x1b58b8;
		dp_catalog_ctrl_read_act_complete_sts.cfi_jt = . + 0x1b58c0;
		dp_catalog_ctrl_channel_alloc.cfi_jt = . + 0x1b58c8;
		dp_catalog_ctrl_update_rg.cfi_jt = . + 0x1b58d0;
		dp_catalog_ctrl_channel_dealloc.cfi_jt = . + 0x1b58d8;
		dp_catalog_ctrl_late_phy_init.cfi_jt = . + 0x1b58e0;
		dp_catalog_aux_read_data.cfi_jt = . + 0x1b58e8;
		dp_catalog_aux_write_data.cfi_jt = . + 0x1b58f0;
		dp_catalog_aux_write_trans.cfi_jt = . + 0x1b58f8;
		dp_catalog_aux_clear_trans.cfi_jt = . + 0x1b5900;
		dp_catalog_aux_update_cfg.cfi_jt = . + 0x1b5908;
		dp_catalog_aux_enable.cfi_jt = . + 0x1b5910;
		dp_catalog_aux_get_irq.cfi_jt = . + 0x1b5918;
		dp_catalog_ctrl_phy_lane_cfg.cfi_jt = . + 0x1b5920;
		dp_catalog_ctrl_phy_lane_cfg_v420.cfi_jt = . + 0x1b5928;
		dp_catalog_ctrl_update_vx_px.cfi_jt = . + 0x1b5930;
		dp_catalog_ctrl_update_vx_px_v420.cfi_jt = . + 0x1b5938;
		dp_catalog_ctrl_config_ctrl.cfi_jt = . + 0x1b5940;
		dp_catalog_ctrl_lane_pnswap.cfi_jt = . + 0x1b5948;
		dp_catalog_ctrl_mainlink_levels.cfi_jt = . + 0x1b5950;
		dp_catalog_ctrl_lane_pnswap_v420.cfi_jt = . + 0x1b5958;
		dp_catalog_put_v420.cfi_jt = . + 0x1b5960;
		dp_catalog_put_v200.cfi_jt = . + 0x1b5968;
		dp_catalog_aux_reset.cfi_jt = . + 0x1b5970;
		dp_catalog_aux_clear_hw_interrupts.cfi_jt = . + 0x1b5978;
		dp_catalog_aux_clear_hw_int_v420.cfi_jt = . + 0x1b5980;
		dp_catalog_aux_clear_hw_int_v200.cfi_jt = . + 0x1b5988;
		dp_catalog_aux_setup.cfi_jt = . + 0x1b5990;
		dp_catalog_aux_setup_v420.cfi_jt = . + 0x1b5998;
		dp_catalog_aux_setup_v200.cfi_jt = . + 0x1b59a0;
		dp_catalog_panel_config_msa.cfi_jt = . + 0x1b59a8;
		dp_catalog_panel_config_msa_v420.cfi_jt = . + 0x1b59b0;
		dp_catalog_panel_config_msa_v200.cfi_jt = . + 0x1b59b8;
		dp_catalog_ctrl_lane_mapping.cfi_jt = . + 0x1b59c0;
		dp_catalog_ctrl_lane_mapping_v200.cfi_jt = . + 0x1b59c8;
		dp_catalog_ctrl_mainlink_ctrl.cfi_jt = . + 0x1b59d0;
		dp_catalog_ctrl_usb_reset.cfi_jt = . + 0x1b59d8;
		dp_catalog_ctrl_enable_irq.cfi_jt = . + 0x1b59e0;
		dp_catalog_ctrl_mst_config.cfi_jt = . + 0x1b59e8;
		dp_catalog_ctrl_fec_config.cfi_jt = . + 0x1b59f0;
		dp_catalog_ctrl_usb_reset_v200.cfi_jt = . + 0x1b59f8;
		dp_aux_init.cfi_jt = . + 0x1b5a00;
		dp_aux_register.cfi_jt = . + 0x1b5a08;
		dp_aux_isr.cfi_jt = . + 0x1b5a10;
		dp_aux_deinit.cfi_jt = . + 0x1b5a18;
		dp_aux_deregister.cfi_jt = . + 0x1b5a20;
		dp_aux_reconfig.cfi_jt = . + 0x1b5a28;
		dp_aux_abort_transaction.cfi_jt = . + 0x1b5a30;
		dp_aux_set_sim_mode.cfi_jt = . + 0x1b5a38;
		dp_aux_configure_aux_switch.cfi_jt = . + 0x1b5a40;
		dp_aux_transfer.cfi_jt = . + 0x1b5a48;
		dp_aux_transfer_debug.cfi_jt = . + 0x1b5a50;
		dp_aux_bridge_transfer.cfi_jt = . + 0x1b5a58;
		dp_panel_hw_cfg.cfi_jt = . + 0x1b5a60;
		dp_panel_read_sink_caps.cfi_jt = . + 0x1b5a68;
		dp_panel_get_mode_bpp.cfi_jt = . + 0x1b5a70;
		dp_panel_get_modes.cfi_jt = . + 0x1b5a78;
		dp_panel_handle_sink_request.cfi_jt = . + 0x1b5a80;
		dp_panel_tpg_config.cfi_jt = . + 0x1b5a88;
		dp_panel_init_panel_info.cfi_jt = . + 0x1b5a90;
		dp_panel_spd_config.cfi_jt = . + 0x1b5a98;
		dp_panel_setup_hdr.cfi_jt = . + 0x1b5aa0;
		dp_panel_deinit_panel_info.cfi_jt = . + 0x1b5aa8;
		dp_panel_set_colorspace.cfi_jt = . + 0x1b5ab0;
		dp_panel_set_stream_info.cfi_jt = . + 0x1b5ab8;
		dp_panel_read_sink_sts.cfi_jt = . + 0x1b5ac0;
		dp_panel_update_edid.cfi_jt = . + 0x1b5ac8;
		dp_panel_hdr_supported.cfi_jt = . + 0x1b5ad0;
		dp_panel_read_mst_cap.cfi_jt = . + 0x1b5ad8;
		dp_panel_convert_to_dp_mode.cfi_jt = . + 0x1b5ae0;
		dp_panel_update_pps.cfi_jt = . + 0x1b5ae8;
		dp_link_get_test_bits_depth.cfi_jt = . + 0x1b5af0;
		dp_link_process_request.cfi_jt = . + 0x1b5af8;
		dp_link_get_colorimetry_config.cfi_jt = . + 0x1b5b00;
		dp_link_adjust_levels.cfi_jt = . + 0x1b5b08;
		dp_link_send_psm_request.cfi_jt = . + 0x1b5b10;
		dp_link_send_test_response.cfi_jt = . + 0x1b5b18;
		dp_link_psm_config.cfi_jt = . + 0x1b5b20;
		dp_link_send_edid_checksum.cfi_jt = . + 0x1b5b28;
		dp_ctrl_host_init.cfi_jt = . + 0x1b5b30;
		dp_ctrl_on.cfi_jt = . + 0x1b5b38;
		dp_ctrl_set_sim_mode.cfi_jt = . + 0x1b5b40;
		dp_ctrl_abort.cfi_jt = . + 0x1b5b48;
		dp_ctrl_link_maintenance.cfi_jt = . + 0x1b5b50;
		dp_ctrl_host_deinit.cfi_jt = . + 0x1b5b58;
		dp_ctrl_off.cfi_jt = . + 0x1b5b60;
		dp_ctrl_isr.cfi_jt = . + 0x1b5b68;
		dp_ctrl_process_phy_test_request.cfi_jt = . + 0x1b5b70;
		dp_ctrl_stream_on.cfi_jt = . + 0x1b5b78;
		dp_ctrl_stream_off.cfi_jt = . + 0x1b5b80;
		dp_ctrl_stream_pre_off.cfi_jt = . + 0x1b5b88;
		dp_ctrl_set_mst_channel_info.cfi_jt = . + 0x1b5b90;
		dp_audio_on.cfi_jt = . + 0x1b5b98;
		dp_audio_off.cfi_jt = . + 0x1b5ba0;
		dp_audio_info_setup.cfi_jt = . + 0x1b5ba8;
		dp_audio_get_edid_blk.cfi_jt = . + 0x1b5bb0;
		dp_audio_get_cable_status.cfi_jt = . + 0x1b5bb8;
		dp_audio_ack_done.cfi_jt = . + 0x1b5bc0;
		dp_debug_abort.cfi_jt = . + 0x1b5bc8;
		dp_debug_set_mst_con.cfi_jt = . + 0x1b5bd0;
		dp_sim_register_hpd.cfi_jt = . + 0x1b5bd8;
		dp_sim_transfer.cfi_jt = . + 0x1b5be0;
		dp_bridge_hpd_register.cfi_jt = . + 0x1b5be8;
		dp_gpio_hpd_register.cfi_jt = . + 0x1b5bf0;
		dp_lphw_hpd_register.cfi_jt = . + 0x1b5bf8;
		dp_hpd_isr.cfi_jt = . + 0x1b5c00;
		dp_lphw_hpd_isr.cfi_jt = . + 0x1b5c08;
		dp_hpd_host_init.cfi_jt = . + 0x1b5c10;
		dp_hpd_host_deinit.cfi_jt = . + 0x1b5c18;
		dp_lphw_hpd_host_init.cfi_jt = . + 0x1b5c20;
		dp_lphw_hpd_host_deinit.cfi_jt = . + 0x1b5c28;
		dp_altmode_simulate_connect.cfi_jt = . + 0x1b5c30;
		dp_bridge_hpd_simulate_connect.cfi_jt = . + 0x1b5c38;
		dp_gpio_hpd_simulate_connect.cfi_jt = . + 0x1b5c40;
		dp_lphw_hpd_simulate_connect.cfi_jt = . + 0x1b5c48;
		dp_altmode_simulate_attention.cfi_jt = . + 0x1b5c50;
		dp_bridge_hpd_simulate_attention.cfi_jt = . + 0x1b5c58;
		dp_gpio_hpd_simulate_attention.cfi_jt = . + 0x1b5c60;
		dp_lphw_hpd_simulate_attention.cfi_jt = . + 0x1b5c68;
		dp_debug_sim_hpd_cb.cfi_jt = . + 0x1b5c70;
		dp_bridge_hpd_cb.cfi_jt = . + 0x1b5c78;
		dp_display_bridge_internal_hpd.cfi_jt = . + 0x1b5c80;
		dp_display_validate_mode.cfi_jt = . + 0x1b5c88;
		dp_display_set_mode.cfi_jt = . + 0x1b5c90;
		dp_display_get_modes.cfi_jt = . + 0x1b5c98;
		dp_display_enable.cfi_jt = . + 0x1b5ca0;
		dp_display_post_enable.cfi_jt = . + 0x1b5ca8;
		dp_display_pre_disable.cfi_jt = . + 0x1b5cb0;
		dp_display_disable.cfi_jt = . + 0x1b5cb8;
		dp_display_prepare.cfi_jt = . + 0x1b5cc0;
		dp_display_unprepare.cfi_jt = . + 0x1b5cc8;
		dp_get_debug.cfi_jt = . + 0x1b5cd0;
		dp_display_config_hdr.cfi_jt = . + 0x1b5cd8;
		dp_display_mst_install.cfi_jt = . + 0x1b5ce0;
		dp_request_irq.cfi_jt = . + 0x1b5ce8;
		dp_display_post_init.cfi_jt = . + 0x1b5cf0;
		dp_display_mst_uninstall.cfi_jt = . + 0x1b5cf8;
		dp_display_mst_connector_update_edid.cfi_jt = . + 0x1b5d00;
		dp_display_mst_connector_install.cfi_jt = . + 0x1b5d08;
		dp_display_mst_connector_uninstall.cfi_jt = . + 0x1b5d10;
		dp_display_mst_connector_update_link_info.cfi_jt = . + 0x1b5d18;
		dp_display_get_mst_caps.cfi_jt = . + 0x1b5d20;
		dp_display_set_stream_info.cfi_jt = . + 0x1b5d28;
		dp_display_update_pps.cfi_jt = . + 0x1b5d30;
		dp_display_convert_to_dp_mode.cfi_jt = . + 0x1b5d38;
		dp_display_mst_get_fixed_topology_port.cfi_jt = . + 0x1b5d40;
		dp_display_wakeup_phy_layer.cfi_jt = . + 0x1b5d48;
		dp_display_setup_colospace.cfi_jt = . + 0x1b5d50;
		dp_display_get_available_dp_resources.cfi_jt = . + 0x1b5d58;
		dp_display_get_display_type.cfi_jt = . + 0x1b5d60;
		dp_display_mst_get_fixed_topology_display_type.cfi_jt = . + 0x1b5d68;
		dp_display_notify_hdcp_status_cb.cfi_jt = . + 0x1b5d70;
		dp_connector_update_pps.cfi_jt = . + 0x1b5d78;
		dp_connector_install_properties.cfi_jt = . + 0x1b5d80;
		dp_hdcp2p2_min_level_change.cfi_jt = . + 0x1b5d88;
		dp_hdcp2p2_wakeup.cfi_jt = . + 0x1b5d90;
		dp_hdcp2p2_register_streams.cfi_jt = . + 0x1b5d98;
		dp_hdcp2p2_deregister_streams.cfi_jt = . + 0x1b5da0;
		dp_hdcp2p2_feature_supported.cfi_jt = . + 0x1b5da8;
		dp_hdcp2p2_supported.cfi_jt = . + 0x1b5db0;
		sde_hdcp_1x_feature_supported.cfi_jt = . + 0x1b5db8;
		sde_hdcp_1x_sink_support.cfi_jt = . + 0x1b5dc0;
		sde_hdcp_2x_client_feature_supported.cfi_jt = . + 0x1b5dc8;
		sde_hdcp_2x_wakeup.cfi_jt = . + 0x1b5dd0;
		of_clk_src_onecell_get.cfi_jt = . + 0x1b5dd8;
		dp_pll_configure.cfi_jt = . + 0x1b5de0;
		dp_pll_configure.3133.cfi_jt = . + 0x1b5de8;
		dp_pll_prepare.cfi_jt = . + 0x1b5df0;
		dp_pll_unprepare.cfi_jt = . + 0x1b5df8;
		dp_pll_prepare.3134.cfi_jt = . + 0x1b5e00;
		dp_pll_unprepare.3135.cfi_jt = . + 0x1b5e08;
		dp_connector_config_hdr.cfi_jt = . + 0x1b5e10;
		dp_mst_connector_config_hdr.cfi_jt = . + 0x1b5e18;
		dp_mst_fixed_connector_detect.cfi_jt = . + 0x1b5e20;
		dp_mst_connector_detect.cfi_jt = . + 0x1b5e28;
		dp_mst_duplicate_bridge_state.cfi_jt = . + 0x1b5e30;
		dp_mst_destroy_bridge_state.cfi_jt = . + 0x1b5e38;
		dp_mst_add_fixed_connector.cfi_jt = . + 0x1b5e40;
		dp_mst_add_connector.cfi_jt = . + 0x1b5e48;
		dp_mst_fixed_atomic_best_encoder.cfi_jt = . + 0x1b5e50;
		dp_mst_atomic_best_encoder.cfi_jt = . + 0x1b5e58;
		dp_mst_calc_pbn_mode.cfi_jt = . + 0x1b5e60;
		drm_dp_find_vcpi_slots.cfi_jt = . + 0x1b5e68;
		drm_dp_atomic_find_vcpi_slots.cfi_jt = . + 0x1b5e70;
		drm_dp_mst_allocate_vcpi.cfi_jt = . + 0x1b5e78;
		drm_dp_update_payload_part1.cfi_jt = . + 0x1b5e80;
		drm_dp_check_act_status.cfi_jt = . + 0x1b5e88;
		drm_dp_update_payload_part2.cfi_jt = . + 0x1b5e90;
		dp_mst_detect_port.cfi_jt = . + 0x1b5e98;
		drm_dp_mst_get_edid.cfi_jt = . + 0x1b5ea0;
		drm_dp_mst_topology_mgr_set_mst.cfi_jt = . + 0x1b5ea8;
		drm_dp_atomic_release_vcpi_slots.cfi_jt = . + 0x1b5eb0;
		_dp_mst_get_vcpi_info.cfi_jt = . + 0x1b5eb8;
		drm_dp_mst_reset_vcpi_slots.cfi_jt = . + 0x1b5ec0;
		drm_dp_mst_deallocate_vcpi.cfi_jt = . + 0x1b5ec8;
		sde_rotator_put_userptr.cfi_jt = . + 0x1b5ed0;
		sde_rotator_device_run.cfi_jt = . + 0x1b5ed8;
		sde_rotator_job_abort.cfi_jt = . + 0x1b5ee0;
		sde_mdp_writeback_intr_done.cfi_jt = . + 0x1b5ee8;
		dp_altmode_register.cfi_jt = . + 0x1b5ef0;
		dp_sim_host_hpd_irq.cfi_jt = . + 0x1b5ef8;
		dp_hdcp2p2_off.cfi_jt = . + 0x1b5f00;
		sde_hdcp_1x_off.cfi_jt = . + 0x1b5f08;
		dp_mst_display_hpd_irq.cfi_jt = . + 0x1b5f10;
		dp_mst_set_state.cfi_jt = . + 0x1b5f18;
		sde_crtc_frame_event_cb.cfi_jt = . + 0x1b5f20;
		__sgl_cmp.cfi_jt = . + 0x1b5f28;
		__irq_cmp.cfi_jt = . + 0x1b5f30;
		pstate_cmp.cfi_jt = . + 0x1b5f38;
		sde_crtc_vblank_cb.cfi_jt = . + 0x1b5f40;
		sde_crtc_atomic_set_property.cfi_jt = . + 0x1b5f48;
		delayed_work_timer_fn.cfi_jt = . + 0x1b5f50;
		kthread_delayed_work_timer_fn.cfi_jt = . + 0x1b5f58;
		sde_crtc_mode_fixup.cfi_jt = . + 0x1b5f60;
		sde_crtc_atomic_check.cfi_jt = . + 0x1b5f68;
		drm_atomic_helper_set_config.cfi_jt = . + 0x1b5f70;
		drm_atomic_helper_page_flip.cfi_jt = . + 0x1b5f78;
		sde_crtc_duplicate_state.cfi_jt = . + 0x1b5f80;
		sde_crtc_atomic_begin.cfi_jt = . + 0x1b5f88;
		sde_crtc_atomic_flush.cfi_jt = . + 0x1b5f90;
		sde_crtc_enable.cfi_jt = . + 0x1b5f98;
		sde_crtc_destroy_state.cfi_jt = . + 0x1b5fa0;
		sde_crtc_atomic_get_property.cfi_jt = . + 0x1b5fa8;
		sde_crtc_get_vblank_counter.cfi_jt = . + 0x1b5fb0;
		sde_crtc_late_register.cfi_jt = . + 0x1b5fb8;
		sde_crtc_enable_vblank.cfi_jt = . + 0x1b5fc0;
		sde_crtc_get_vblank_timestamp.cfi_jt = . + 0x1b5fc8;
		sde_encoder_helper_setup_misr.cfi_jt = . + 0x1b5fd0;
		sde_encoder_helper_collect_misr.cfi_jt = . + 0x1b5fd8;
		sde_encoder_input_event_handler.cfi_jt = . + 0x1b5fe0;
		_sde_encoder_input_connect.cfi_jt = . + 0x1b5fe8;
		_sde_encoder_input_disconnect.cfi_jt = . + 0x1b5ff0;
		sde_encoder_virt_mode_set.cfi_jt = . + 0x1b5ff8;
		sde_encoder_virt_atomic_check.cfi_jt = . + 0x1b6000;
		sde_encoder_late_register.cfi_jt = . + 0x1b6008;
		sde_encoder_destroy.cfi_jt = . + 0x1b6010;
		sde_encoder_virt_disable.cfi_jt = . + 0x1b6018;
		sde_encoder_virt_enable.cfi_jt = . + 0x1b6020;
		sde_encoder_early_unregister.cfi_jt = . + 0x1b6028;
		sde_encoder_vblank_callback.cfi_jt = . + 0x1b6030;
		sde_encoder_underrun_callback.cfi_jt = . + 0x1b6038;
		sde_encoder_frame_done_callback.cfi_jt = . + 0x1b6040;
		_sde_encoder_get_qsync_fps_callback.cfi_jt = . + 0x1b6048;
		sde_encoder_phys_vid_get_underrun_line_count.cfi_jt = . + 0x1b6050;
		sde_encoder_phys_vid_control_vblank_irq.cfi_jt = . + 0x1b6058;
		sde_encoder_phys_cmd_control_vblank_irq.cfi_jt = . + 0x1b6060;
		sde_encoder_phys_vid_cont_splash_mode_set.cfi_jt = . + 0x1b6068;
		sde_encoder_phys_cmd_cont_splash_mode_set.cfi_jt = . + 0x1b6070;
		sde_encoder_phys_vid_mode_fixup.cfi_jt = . + 0x1b6078;
		sde_encoder_phys_cmd_mode_fixup.cfi_jt = . + 0x1b6080;
		sde_encoder_phys_cmd_update_split_role.cfi_jt = . + 0x1b6088;
		sde_encoder_phys_cmd_setup_vsync_source.cfi_jt = . + 0x1b6090;
		sde_irq.cfi_jt = . + 0x1b6098;
		sde_core_irqdomain_map.cfi_jt = . + 0x1b60a0;
		irq_domain_xlate_onecell.cfi_jt = . + 0x1b60a8;
		handle_level_irq.cfi_jt = . + 0x1b60b0;
		sde_core_irq_mask.cfi_jt = . + 0x1b60b8;
		sde_core_irq_unmask.cfi_jt = . + 0x1b60c0;
		trace_raw_output_sde_rot_evtlog.cfi_jt = . + 0x1b60c8;
		trace_raw_output_rot_trace_counter.cfi_jt = . + 0x1b60d0;
		trace_raw_output_rot_perf_set_wm_levels.cfi_jt = . + 0x1b60d8;
		trace_raw_output_rot_perf_set_qos_luts.cfi_jt = . + 0x1b60e0;
		trace_raw_output_rot_perf_set_panic_luts.cfi_jt = . + 0x1b60e8;
		trace_raw_output_rot_perf_set_ot.cfi_jt = . + 0x1b60f0;
		trace_raw_output_rot_perf_prefill_calc.cfi_jt = . + 0x1b60f8;
		trace_raw_output_rot_mark_write.cfi_jt = . + 0x1b6100;
		trace_raw_output_rot_entry_template.cfi_jt = . + 0x1b6108;
		trace_raw_output_rot_bw_ao_as_context.cfi_jt = . + 0x1b6110;
		trace_raw_output_tracing_mark_write.cfi_jt = . + 0x1b6118;
		trace_raw_output_sde_perf_update_bus.cfi_jt = . + 0x1b6120;
		trace_raw_output_sde_perf_uidle_status.cfi_jt = . + 0x1b6128;
		trace_raw_output_sde_perf_uidle_cntr.cfi_jt = . + 0x1b6130;
		trace_raw_output_sde_perf_set_qos_luts.cfi_jt = . + 0x1b6138;
		trace_raw_output_sde_perf_set_ot.cfi_jt = . + 0x1b6140;
		trace_raw_output_sde_perf_crtc_update.cfi_jt = . + 0x1b6148;
		trace_raw_output_sde_perf_calc_crtc.cfi_jt = . + 0x1b6150;
		trace_raw_output_sde_evtlog.cfi_jt = . + 0x1b6158;
		trace_raw_output_sde_encoder_underrun.cfi_jt = . + 0x1b6160;
		trace_raw_output_sde_cmd_release_bw.cfi_jt = . + 0x1b6168;
		__traceiter_tracing_mark_write.cfi_jt = . + 0x1b6170;
		__traceiter_sde_perf_update_bus.cfi_jt = . + 0x1b6178;
		__traceiter_sde_perf_uidle_status.cfi_jt = . + 0x1b6180;
		__traceiter_rot_perf_set_wm_levels.cfi_jt = . + 0x1b6188;
		__traceiter_sde_perf_uidle_cntr.cfi_jt = . + 0x1b6190;
		__traceiter_sde_perf_set_qos_luts.cfi_jt = . + 0x1b6198;
		__traceiter_sde_perf_set_ot.cfi_jt = . + 0x1b61a0;
		__traceiter_sde_perf_crtc_update.cfi_jt = . + 0x1b61a8;
		__traceiter_sde_perf_calc_crtc.cfi_jt = . + 0x1b61b0;
		__traceiter_sde_rot_evtlog.cfi_jt = . + 0x1b61b8;
		__traceiter_sde_evtlog.cfi_jt = . + 0x1b61c0;
		trace_event_raw_event_tracing_mark_write.cfi_jt = . + 0x1b61c8;
		perf_trace_tracing_mark_write.cfi_jt = . + 0x1b61d0;
		__bpf_trace_tracing_mark_write.cfi_jt = . + 0x1b61d8;
		trace_event_raw_event_sde_perf_update_bus.cfi_jt = . + 0x1b61e0;
		perf_trace_sde_perf_update_bus.cfi_jt = . + 0x1b61e8;
		__bpf_trace_sde_perf_update_bus.cfi_jt = . + 0x1b61f0;
		trace_event_raw_event_sde_perf_uidle_status.cfi_jt = . + 0x1b61f8;
		perf_trace_sde_perf_uidle_status.cfi_jt = . + 0x1b6200;
		__bpf_trace_sde_perf_uidle_status.cfi_jt = . + 0x1b6208;
		trace_event_raw_event_rot_perf_set_wm_levels.cfi_jt = . + 0x1b6210;
		perf_trace_rot_perf_set_wm_levels.cfi_jt = . + 0x1b6218;
		__bpf_trace_rot_perf_set_wm_levels.cfi_jt = . + 0x1b6220;
		trace_event_raw_event_sde_perf_uidle_cntr.cfi_jt = . + 0x1b6228;
		perf_trace_sde_perf_uidle_cntr.cfi_jt = . + 0x1b6230;
		__bpf_trace_sde_perf_uidle_cntr.cfi_jt = . + 0x1b6238;
		trace_event_raw_event_sde_perf_set_qos_luts.cfi_jt = . + 0x1b6240;
		perf_trace_sde_perf_set_qos_luts.cfi_jt = . + 0x1b6248;
		__bpf_trace_sde_perf_set_qos_luts.cfi_jt = . + 0x1b6250;
		trace_event_raw_event_sde_perf_set_ot.cfi_jt = . + 0x1b6258;
		perf_trace_sde_perf_set_ot.cfi_jt = . + 0x1b6260;
		__bpf_trace_sde_perf_set_ot.cfi_jt = . + 0x1b6268;
		trace_event_raw_event_sde_perf_crtc_update.cfi_jt = . + 0x1b6270;
		perf_trace_sde_perf_crtc_update.cfi_jt = . + 0x1b6278;
		__bpf_trace_sde_perf_crtc_update.cfi_jt = . + 0x1b6280;
		trace_event_raw_event_sde_perf_calc_crtc.cfi_jt = . + 0x1b6288;
		perf_trace_sde_perf_calc_crtc.cfi_jt = . + 0x1b6290;
		__bpf_trace_sde_perf_calc_crtc.cfi_jt = . + 0x1b6298;
		trace_event_raw_event_sde_rot_evtlog.cfi_jt = . + 0x1b62a0;
		perf_trace_sde_rot_evtlog.cfi_jt = . + 0x1b62a8;
		__bpf_trace_sde_rot_evtlog.cfi_jt = . + 0x1b62b0;
		trace_event_raw_event_sde_evtlog.cfi_jt = . + 0x1b62b8;
		perf_trace_sde_evtlog.cfi_jt = . + 0x1b62c0;
		__bpf_trace_sde_evtlog.cfi_jt = . + 0x1b62c8;
		trace_event_raw_event_sde_encoder_underrun.cfi_jt = . + 0x1b62d0;
		perf_trace_sde_encoder_underrun.cfi_jt = . + 0x1b62d8;
		__bpf_trace_sde_encoder_underrun.cfi_jt = . + 0x1b62e0;
		_sde_vm_resource_init.cfi_jt = . + 0x1b62e8;
		sde_kms_vm_primary_prepare_commit.cfi_jt = . + 0x1b62f0;
		sde_kms_vm_trusted_prepare_commit.cfi_jt = . + 0x1b62f8;
		sde_kms_vm_trusted_post_commit.cfi_jt = . + 0x1b6300;
		sde_kms_vm_primary_post_commit.cfi_jt = . + 0x1b6308;
		sde_kms_display_early_wakeup.cfi_jt = . + 0x1b6310;
		sde_kms_get_msm_mode.cfi_jt = . + 0x1b6318;
		sde_kms_prepare_fence.cfi_jt = . + 0x1b6320;
		sde_kms_prepare_commit.cfi_jt = . + 0x1b6328;
		sde_kms_commit.cfi_jt = . + 0x1b6330;
		sde_kms_complete_commit.cfi_jt = . + 0x1b6338;
		sde_kms_wait_for_frame_transfer_complete.cfi_jt = . + 0x1b6340;
		sde_kms_wait_for_commit_done.cfi_jt = . + 0x1b6348;
		sde_kms_round_pixclk.cfi_jt = . + 0x1b6350;
		_sde_kms_post_open.cfi_jt = . + 0x1b6358;
		sde_kms_preclose.cfi_jt = . + 0x1b6360;
		_sde_kms_register_events.cfi_jt = . + 0x1b6368;
		_sde_kms_get_address_space.cfi_jt = . + 0x1b6370;
		_sde_kms_get_address_space_device.cfi_jt = . + 0x1b6378;
		sde_irq_preinstall.cfi_jt = . + 0x1b6380;
		sde_irq_uninstall.cfi_jt = . + 0x1b6388;
		sde_kms_lastclose.cfi_jt = . + 0x1b6390;
		sde_kms_destroy.cfi_jt = . + 0x1b6398;
		sde_kms_debugfs_destroy.cfi_jt = . + 0x1b63a0;
		sde_kms_atomic_check.cfi_jt = . + 0x1b63a8;
		sde_kms_cont_splash_config.cfi_jt = . + 0x1b63b0;
		sde_kms_check_for_splash.cfi_jt = . + 0x1b63b8;
		sde_irq_postinstall.cfi_jt = . + 0x1b63c0;
		sde_kms_hw_init.cfi_jt = . + 0x1b63c8;
		sde_kms_postinit.cfi_jt = . + 0x1b63d0;
		sde_kms_trigger_null_flush.cfi_jt = . + 0x1b63d8;
		sde_kms_get_mixer_count.cfi_jt = . + 0x1b63e0;
		sde_kms_get_dsc_count.cfi_jt = . + 0x1b63e8;
		sde_kms_pd_disable.cfi_jt = . + 0x1b63f0;
		sde_kms_pd_enable.cfi_jt = . + 0x1b63f8;
		sde_crtc_handle_power_event.cfi_jt = . + 0x1b6400;
		sde_kms_handle_power_event.cfi_jt = . + 0x1b6408;
		sde_kms_irq_affinity_notify.cfi_jt = . + 0x1b6410;
		sde_plane_atomic_set_property.cfi_jt = . + 0x1b6418;
		sde_plane_prepare_fb.cfi_jt = . + 0x1b6420;
		sde_plane_atomic_check.cfi_jt = . + 0x1b6428;
		drm_atomic_helper_update_plane.cfi_jt = . + 0x1b6430;
		drm_atomic_helper_disable_plane.cfi_jt = . + 0x1b6438;
		sde_plane_duplicate_state.cfi_jt = . + 0x1b6440;
		sde_plane_atomic_update.cfi_jt = . + 0x1b6448;
		sde_plane_cleanup_fb.cfi_jt = . + 0x1b6450;
		sde_plane_destroy_state.cfi_jt = . + 0x1b6458;
		sde_plane_atomic_get_property.cfi_jt = . + 0x1b6460;
		sde_plane_late_register.cfi_jt = . + 0x1b6468;
		sde_plane_destroy.cfi_jt = . + 0x1b6470;
		sde_plane_reset.cfi_jt = . + 0x1b6478;
		sde_plane_early_unregister.cfi_jt = . + 0x1b6480;
		sde_connector_atomic_set_property.cfi_jt = . + 0x1b6488;
		sde_connector_fill_modes.cfi_jt = . + 0x1b6490;
		sde_connector_handle_disp_recovery.cfi_jt = . + 0x1b6498;
		sde_connector_handle_panel_id.cfi_jt = . + 0x1b64a0;
		sde_backlight_device_update_status.cfi_jt = . + 0x1b64a8;
		sde_backlight_device_get_brightness.cfi_jt = . + 0x1b64b0;
		sde_connector_detect_ctx.cfi_jt = . + 0x1b64b8;
		sde_connector_mode_valid.cfi_jt = . + 0x1b64c0;
		sde_connector_best_encoder.cfi_jt = . + 0x1b64c8;
		sde_connector_atomic_best_encoder.cfi_jt = . + 0x1b64d0;
		sde_connector_atomic_check.cfi_jt = . + 0x1b64d8;
		sde_connector_get_modes.cfi_jt = . + 0x1b64e0;
		sde_connector_late_register.cfi_jt = . + 0x1b64e8;
		sde_connector_destroy.cfi_jt = . + 0x1b64f0;
		sde_connector_atomic_reset.cfi_jt = . + 0x1b64f8;
		sde_connector_early_unregister.cfi_jt = . + 0x1b6500;
		sde_connector_atomic_duplicate_state.cfi_jt = . + 0x1b6508;
		sde_connector_atomic_destroy_state.cfi_jt = . + 0x1b6510;
		sde_connector_atomic_get_property.cfi_jt = . + 0x1b6518;
		sde_crtc_disable.cfi_jt = . + 0x1b6520;
		sde_crtc_reset.cfi_jt = . + 0x1b6528;
		sde_crtc_destroy.cfi_jt = . + 0x1b6530;
		sde_crtc_early_unregister.cfi_jt = . + 0x1b6538;
		sde_crtc_disable_vblank.cfi_jt = . + 0x1b6540;
		_dspp_pcc_install_property.cfi_jt = . + 0x1b6548;
		_dspp_hsic_install_property.cfi_jt = . + 0x1b6550;
		_dspp_memcolor_install_property.cfi_jt = . + 0x1b6558;
		_dspp_sixzone_install_property.cfi_jt = . + 0x1b6560;
		_dspp_ad_install_property.cfi_jt = . + 0x1b6568;
		_dspp_ltm_install_property.cfi_jt = . + 0x1b6570;
		_dspp_spr_install_property.cfi_jt = . + 0x1b6578;
		_dspp_vlut_install_property.cfi_jt = . + 0x1b6580;
		_dspp_gamut_install_property.cfi_jt = . + 0x1b6588;
		_dspp_gc_install_property.cfi_jt = . + 0x1b6590;
		_dspp_igc_install_property.cfi_jt = . + 0x1b6598;
		_dspp_hist_install_property.cfi_jt = . + 0x1b65a0;
		_dspp_dither_install_property.cfi_jt = . + 0x1b65a8;
		_dspp_rc_install_property.cfi_jt = . + 0x1b65b0;
		_dspp_demura_install_property.cfi_jt = . + 0x1b65b8;
		_lm_gc_install_property.cfi_jt = . + 0x1b65c0;
		_feature_unsupported.cfi_jt = . + 0x1b65c8;
		_set_dspp_vlut_feature.cfi_jt = . + 0x1b65d0;
		_set_dspp_pcc_feature.cfi_jt = . + 0x1b65d8;
		_set_dspp_igc_feature.cfi_jt = . + 0x1b65e0;
		_set_dspp_gc_feature.cfi_jt = . + 0x1b65e8;
		_set_dspp_hsic_feature.cfi_jt = . + 0x1b65f0;
		_set_dspp_memcol_skin_feature.cfi_jt = . + 0x1b65f8;
		_set_dspp_memcol_sky_feature.cfi_jt = . + 0x1b6600;
		_set_dspp_memcol_foliage_feature.cfi_jt = . + 0x1b6608;
		_set_dspp_memcol_prot_feature.cfi_jt = . + 0x1b6610;
		_set_dspp_sixzone_feature.cfi_jt = . + 0x1b6618;
		_set_dspp_gamut_feature.cfi_jt = . + 0x1b6620;
		_set_dspp_dither_feature.cfi_jt = . + 0x1b6628;
		_set_dspp_hist_ctrl_feature.cfi_jt = . + 0x1b6630;
		_set_dspp_hist_irq_feature.cfi_jt = . + 0x1b6638;
		_set_dspp_ad_mode_feature.cfi_jt = . + 0x1b6640;
		_set_dspp_ad_init_feature.cfi_jt = . + 0x1b6648;
		_set_dspp_ad_cfg_feature.cfi_jt = . + 0x1b6650;
		_set_dspp_ad_input_feature.cfi_jt = . + 0x1b6658;
		_set_dspp_ad_assertive_feature.cfi_jt = . + 0x1b6660;
		_set_dspp_ad_backlight_feature.cfi_jt = . + 0x1b6668;
		_set_dspp_ad_strength_feature.cfi_jt = . + 0x1b6670;
		_set_dspp_ad_roi_feature.cfi_jt = . + 0x1b6678;
		_set_lm_gc_feature.cfi_jt = . + 0x1b6680;
		_set_ltm_init_feature.cfi_jt = . + 0x1b6688;
		_set_ltm_roi_feature.cfi_jt = . + 0x1b6690;
		_set_ltm_vlut_feature.cfi_jt = . + 0x1b6698;
		_set_ltm_thresh_feature.cfi_jt = . + 0x1b66a0;
		_set_ltm_buffers_feature.cfi_jt = . + 0x1b66a8;
		_set_ltm_queue_buf_feature.cfi_jt = . + 0x1b66b0;
		_set_ltm_hist_crtl_feature.cfi_jt = . + 0x1b66b8;
		_set_rc_mask_feature.cfi_jt = . + 0x1b66c0;
		_set_spr_init_feature.cfi_jt = . + 0x1b66c8;
		_set_demura_feature.cfi_jt = . + 0x1b66d0;
		_check_rc_mask_feature.cfi_jt = . + 0x1b66d8;
		_set_rc_pu_feature.cfi_jt = . + 0x1b66e0;
		_set_spr_pu_feature.cfi_jt = . + 0x1b66e8;
		_set_demura_pu_feature.cfi_jt = . + 0x1b66f0;
		_check_rc_pu_feature.cfi_jt = . + 0x1b66f8;
		_check_spr_pu_feature.cfi_jt = . + 0x1b6700;
		_dspp_idx_caps_update.cfi_jt = . + 0x1b6708;
		_rc_caps_update.cfi_jt = . + 0x1b6710;
		_demura_caps_update.cfi_jt = . + 0x1b6718;
		_spr_caps_update.cfi_jt = . + 0x1b6720;
		_ltm_caps_update.cfi_jt = . + 0x1b6728;
		_sde_cp_notify_ad_event.cfi_jt = . + 0x1b6730;
		_sde_cp_notify_hist_event.cfi_jt = . + 0x1b6738;
		_sde_cp_notify_ltm_wb_pb.cfi_jt = . + 0x1b6740;
		_sde_cp_notify_ltm_hist.cfi_jt = . + 0x1b6748;
		sde_crtc_power_interrupt_handler.cfi_jt = . + 0x1b6750;
		sde_crtc_idle_interrupt_handler.cfi_jt = . + 0x1b6758;
		sde_crtc_pm_event_handler.cfi_jt = . + 0x1b6760;
		sde_crtc_mmrm_interrupt_handler.cfi_jt = . + 0x1b6768;
		sde_crtc_vm_release_handler.cfi_jt = . + 0x1b6770;
		sde_crtc_frame_data_interrupt_handler.cfi_jt = . + 0x1b6778;
		sde_cp_ad_interrupt.cfi_jt = . + 0x1b6780;
		sde_cp_hist_interrupt.cfi_jt = . + 0x1b6788;
		sde_cp_ltm_hist_interrupt.cfi_jt = . + 0x1b6790;
		sde_cp_ltm_wb_pb_interrupt.cfi_jt = . + 0x1b6798;
		sde_cp_ltm_off_event_handler.cfi_jt = . + 0x1b67a0;
		__mem_sort_cmp.cfi_jt = . + 0x1b67a8;
		_sde_dump_blk_phys_addr_cmp.cfi_jt = . + 0x1b67b0;
		_sde_dump_reg_range_cmp.cfi_jt = . + 0x1b67b8;
		trace_event_raw_event_rot_bw_ao_as_context.cfi_jt = . + 0x1b67c0;
		perf_trace_rot_bw_ao_as_context.cfi_jt = . + 0x1b67c8;
		__bpf_trace_rot_bw_ao_as_context.cfi_jt = . + 0x1b67d0;
		trace_event_raw_event_sde_cmd_release_bw.cfi_jt = . + 0x1b67d8;
		perf_trace_sde_cmd_release_bw.cfi_jt = . + 0x1b67e0;
		__bpf_trace_sde_cmd_release_bw.cfi_jt = . + 0x1b67e8;
		_sde_dbg_sde_clear_test_point.cfi_jt = . + 0x1b67f0;
		_sde_dbg_vbif_clear_test_point.cfi_jt = . + 0x1b67f8;
		_sde_dbg_vbif_disable_block.cfi_jt = . + 0x1b6800;
		_sde_dbg_cmn_clear_test_point.cfi_jt = . + 0x1b6808;
		_sde_dbg_sde_read_test_point.cfi_jt = . + 0x1b6810;
		_sde_dbg_vbif_read_test_point.cfi_jt = . + 0x1b6818;
		_sde_dbg_dsi_read_test_point.cfi_jt = . + 0x1b6820;
		_sde_dbg_rsc_read_test_point.cfi_jt = . + 0x1b6828;
		_sde_dbg_dp_read_test_point.cfi_jt = . + 0x1b6830;
		_sde_dbg_lutdma_read_test_point.cfi_jt = . + 0x1b6838;
		_sde_debug_bus_ppb0_dump.cfi_jt = . + 0x1b6840;
		_sde_debug_bus_ppb1_dump.cfi_jt = . + 0x1b6848;
		_sde_debug_bus_xbar_dump.cfi_jt = . + 0x1b6850;
		_sde_debug_bus_lm_dump.cfi_jt = . + 0x1b6858;
		sde_i2c_byte_write.cfi_jt = . + 0x1b6860;
		sde_i2c_byte_read.cfi_jt = . + 0x1b6868;
		msm_dss_single_clk_set_rate.cfi_jt = . + 0x1b6870;
		msm_dss_put_clk.cfi_jt = . + 0x1b6878;
		msm_dss_mmrm_register.cfi_jt = . + 0x1b6880;
		msm_dss_mmrm_deregister.cfi_jt = . + 0x1b6888;
		msm_dss_iounmap.cfi_jt = . + 0x1b6890;
		msm_dss_ioremap_byname.cfi_jt = . + 0x1b6898;
		msm_dss_get_vreg.cfi_jt = . + 0x1b68a0;
		msm_dss_get_pmic_io_mem.cfi_jt = . + 0x1b68a8;
		msm_dss_get_io_mem.cfi_jt = . + 0x1b68b0;
		msm_dss_get_io_irq.cfi_jt = . + 0x1b68b8;
		msm_dss_get_gpio_io_mem.cfi_jt = . + 0x1b68c0;
		msm_dss_get_clk.cfi_jt = . + 0x1b68c8;
		msm_dss_enable_vreg.cfi_jt = . + 0x1b68d0;
		msm_dss_enable_gpio.cfi_jt = . + 0x1b68d8;
		msm_dss_enable_clk.cfi_jt = . + 0x1b68e0;
		msm_dss_clk_set_rate.cfi_jt = . + 0x1b68e8;
		msm_dss_clean_io_mem.cfi_jt = . + 0x1b68f0;
		msm_dss_clean_io_irq.cfi_jt = . + 0x1b68f8;
		dss_reg_w.cfi_jt = . + 0x1b6900;
		dss_reg_r.cfi_jt = . + 0x1b6908;
		dss_reg_dump.cfi_jt = . + 0x1b6910;
		msm_unregister_vm_event.cfi_jt = . + 0x1b6918;
		msm_register_vm_event.cfi_jt = . + 0x1b6920;
		reg_dmav1_setup_dma_igcv5.cfi_jt = . + 0x1b6928;
		reg_dmav1_setup_dma_gcv5.cfi_jt = . + 0x1b6930;
		reg_dmav1_setup_scaler3_lut.cfi_jt = . + 0x1b6938;
		reg_dmav1_setup_scaler3lite_lut.cfi_jt = . + 0x1b6940;
		sde_setup_dspp_ltm_hist_ctrlv1.cfi_jt = . + 0x1b6948;
		sde_setup_dspp_ltm_hist_bufferv1.cfi_jt = . + 0x1b6950;
		sde_demura_backlight_cfg.cfi_jt = . + 0x1b6958;
		sde_setup_fp16_cscv1.cfi_jt = . + 0x1b6960;
		sde_setup_fp16_gcv1.cfi_jt = . + 0x1b6968;
		sde_setup_fp16_igcv1.cfi_jt = . + 0x1b6970;
		sde_setup_fp16_unmultv1.cfi_jt = . + 0x1b6978;
		sde_ltm_read_intr_status.cfi_jt = . + 0x1b6980;
		sde_demura_read_plane_status.cfi_jt = . + 0x1b6988;
		ad4_mode_setup_common.cfi_jt = . + 0x1b6990;
		ad4_init_setup_idle.cfi_jt = . + 0x1b6998;
		ad4_cfg_setup_idle.cfi_jt = . + 0x1b69a0;
		ad4_input_setup_idle.cfi_jt = . + 0x1b69a8;
		ad4_suspend_setup.cfi_jt = . + 0x1b69b0;
		ad4_assertive_setup.cfi_jt = . + 0x1b69b8;
		ad4_backlight_setup.cfi_jt = . + 0x1b69c0;
		ad4_strength_setup_idle.cfi_jt = . + 0x1b69c8;
		ad4_roi_setup.cfi_jt = . + 0x1b69d0;
		ad4_no_op_setup.cfi_jt = . + 0x1b69d8;
		ad4_init_setup.cfi_jt = . + 0x1b69e0;
		ad4_cfg_setup.cfi_jt = . + 0x1b69e8;
		ad4_input_setup.cfi_jt = . + 0x1b69f0;
		ad4_ipc_reset_setup_startup.cfi_jt = . + 0x1b69f8;
		ad4_init_setup_run.cfi_jt = . + 0x1b6a00;
		ad4_cfg_setup_run.cfi_jt = . + 0x1b6a08;
		ad4_ipc_suspend_setup_run.cfi_jt = . + 0x1b6a10;
		ad4_setup_debug.cfi_jt = . + 0x1b6a18;
		ad4_ipc_resume_setup_ipcs.cfi_jt = . + 0x1b6a20;
		ad4_init_setup_ipcr.cfi_jt = . + 0x1b6a28;
		ad4_cfg_setup_ipcr.cfi_jt = . + 0x1b6a30;
		ad4_input_setup_ipcr.cfi_jt = . + 0x1b6a38;
		ad4_assertive_setup_ipcr.cfi_jt = . + 0x1b6a40;
		ad4_backlight_setup_ipcr.cfi_jt = . + 0x1b6a48;
		ad4_roi_setup_ipcr.cfi_jt = . + 0x1b6a50;
		ad4_ipc_suspend_setup_ipcr.cfi_jt = . + 0x1b6a58;
		ad4_ipc_reset_setup_ipcr.cfi_jt = . + 0x1b6a60;
		ad4_strength_setup.cfi_jt = . + 0x1b6a68;
		ad4_setup_debug_manual.cfi_jt = . + 0x1b6a70;
		sde_validate_dspp_ad4.cfi_jt = . + 0x1b6a78;
		sde_read_intr_resp_ad4.cfi_jt = . + 0x1b6a80;
		sde_hw_uidle_get_status.cfi_jt = . + 0x1b6a88;
		sde_hw_uidle_get_cntr.cfi_jt = . + 0x1b6a90;
		sde_hw_uidle_setup_wd_timer.cfi_jt = . + 0x1b6a98;
		sde_hw_uidle_setup_ctl.cfi_jt = . + 0x1b6aa0;
		sde_hw_uidle_setup_cntr.cfi_jt = . + 0x1b6aa8;
		sde_hw_uilde_active_override.cfi_jt = . + 0x1b6ab0;
		sde_hw_uidle_fal10_override.cfi_jt = . + 0x1b6ab8;
		sde_hw_cdm_disable.cfi_jt = . + 0x1b6ac0;
		sde_hw_cdm_setup_csc_10bit.cfi_jt = . + 0x1b6ac8;
		sde_hw_cdm_enable.cfi_jt = . + 0x1b6ad0;
		sde_hw_cdm_setup_cdwn.cfi_jt = . + 0x1b6ad8;
		sde_hw_cdm_bind_pingpong_blk.cfi_jt = . + 0x1b6ae0;
		sde_ltm_clear_merge_mode.cfi_jt = . + 0x1b6ae8;
		dspp_igc.cfi_jt = . + 0x1b6af0;
		dspp_pcc.cfi_jt = . + 0x1b6af8;
		dspp_gc.cfi_jt = . + 0x1b6b00;
		dspp_hsic.cfi_jt = . + 0x1b6b08;
		dspp_memcolor.cfi_jt = . + 0x1b6b10;
		dspp_sixzone.cfi_jt = . + 0x1b6b18;
		dspp_gamut.cfi_jt = . + 0x1b6b20;
		dspp_dither.cfi_jt = . + 0x1b6b28;
		dspp_hist.cfi_jt = . + 0x1b6b30;
		dspp_vlut.cfi_jt = . + 0x1b6b38;
		dspp_ad.cfi_jt = . + 0x1b6b40;
		dspp_ltm.cfi_jt = . + 0x1b6b48;
		dspp_rc.cfi_jt = . + 0x1b6b50;
		dspp_spr.cfi_jt = . + 0x1b6b58;
		dspp_demura.cfi_jt = . + 0x1b6b60;
		sde_hw_intf_setup_timing_engine.cfi_jt = . + 0x1b6b68;
		sde_hw_intf_setup_prg_fetch.cfi_jt = . + 0x1b6b70;
		sde_hw_intf_enable_timing_engine.cfi_jt = . + 0x1b6b78;
		sde_hw_intf_setup_misr.cfi_jt = . + 0x1b6b80;
		sde_hw_intf_collect_misr.cfi_jt = . + 0x1b6b88;
		sde_hw_intf_avr_setup.cfi_jt = . + 0x1b6b90;
		sde_hw_intf_avr_ctrl.cfi_jt = . + 0x1b6b98;
		sde_hw_intf_enable_compressed_input.cfi_jt = . + 0x1b6ba0;
		sde_hw_intf_enable_wide_bus.cfi_jt = . + 0x1b6ba8;
		sde_hw_intf_get_status.cfi_jt = . + 0x1b6bb0;
		sde_hw_intf_v1_get_status.cfi_jt = . + 0x1b6bb8;
		sde_hw_intf_bind_pingpong_blk.cfi_jt = . + 0x1b6bc0;
		sde_hw_intf_get_line_count.cfi_jt = . + 0x1b6bc8;
		sde_hw_intf_get_underrun_line_count.cfi_jt = . + 0x1b6bd0;
		sde_hw_intf_get_intr_status.cfi_jt = . + 0x1b6bd8;
		sde_hw_intf_get_avr_status.cfi_jt = . + 0x1b6be0;
		sde_hw_intf_setup_te_config.cfi_jt = . + 0x1b6be8;
		sde_hw_intf_update_te.cfi_jt = . + 0x1b6bf0;
		sde_hw_intf_enable_te.cfi_jt = . + 0x1b6bf8;
		sde_hw_intf_connect_external_te.cfi_jt = . + 0x1b6c00;
		sde_hw_intf_get_vsync_info.cfi_jt = . + 0x1b6c08;
		sde_hw_intf_setup_autorefresh_config.cfi_jt = . + 0x1b6c10;
		sde_hw_intf_get_autorefresh_config.cfi_jt = . + 0x1b6c18;
		sde_hw_intf_poll_timeout_wr_ptr.cfi_jt = . + 0x1b6c20;
		sde_hw_intf_v1_check_and_reset_tearcheck.cfi_jt = . + 0x1b6c28;
		sde_hw_intf_setup_vsync_source.cfi_jt = . + 0x1b6c30;
		sde_hw_intf_vsync_sel.cfi_jt = . + 0x1b6c38;
		sde_hw_intf_override_tear_rd_ptr_val.cfi_jt = . + 0x1b6c40;
		sde_hw_intf_avr_trigger.cfi_jt = . + 0x1b6c48;
		sde_hw_intf_reset_counter.cfi_jt = . + 0x1b6c50;
		sde_hw_intf_get_vsync_timestamp.cfi_jt = . + 0x1b6c58;
		sde_hw_lm_setup_out.cfi_jt = . + 0x1b6c60;
		sde_hw_lm_setup_blend_config.cfi_jt = . + 0x1b6c68;
		sde_hw_lm_setup_blend_config_combined_alpha.cfi_jt = . + 0x1b6c70;
		sde_hw_lm_setup_color3.cfi_jt = . + 0x1b6c78;
		sde_hw_lm_setup_border_color.cfi_jt = . + 0x1b6c80;
		sde_hw_lm_gc.cfi_jt = . + 0x1b6c88;
		sde_hw_lm_setup_misr.cfi_jt = . + 0x1b6c90;
		sde_hw_lm_collect_misr.cfi_jt = . + 0x1b6c98;
		sde_hw_lm_setup_dim_layer.cfi_jt = . + 0x1b6ca0;
		sde_hw_lm_clear_dim_layer.cfi_jt = . + 0x1b6ca8;
		sde_hw_lm_setup_noise_layer.cfi_jt = . + 0x1b6cb0;
		sde_hw_ctl_intf_cfg_v1.cfi_jt = . + 0x1b6cb8;
		sde_hw_ctl_update_intf_cfg.cfi_jt = . + 0x1b6cc0;
		sde_hw_ctl_reset_post_disable.cfi_jt = . + 0x1b6cc8;
		sde_hw_ctl_read_active_status.cfi_jt = . + 0x1b6cd0;
		sde_hw_ctl_set_fetch_pipe_active.cfi_jt = . + 0x1b6cd8;
		sde_hw_ctl_intf_cfg.cfi_jt = . + 0x1b6ce0;
		sde_hw_ctl_update_bitmask.cfi_jt = . + 0x1b6ce8;
		sde_hw_ctl_update_bitmask_v1.cfi_jt = . + 0x1b6cf0;
		sde_hw_ctl_update_pending_flush.cfi_jt = . + 0x1b6cf8;
		sde_hw_ctl_update_pending_flush_v1.cfi_jt = . + 0x1b6d00;
		sde_hw_ctl_get_pending_flush.cfi_jt = . + 0x1b6d08;
		sde_hw_ctl_read_ctl_layers.cfi_jt = . + 0x1b6d10;
		sde_hw_ctl_update_wb_cfg.cfi_jt = . + 0x1b6d18;
		sde_hw_ctl_get_scheduler_status.cfi_jt = . + 0x1b6d20;
		sde_hw_ctl_get_active_fetch_pipes.cfi_jt = . + 0x1b6d28;
		sde_hw_ctl_get_intf.cfi_jt = . + 0x1b6d30;
		sde_hw_ctl_get_intf_v1.cfi_jt = . + 0x1b6d38;
		sde_hw_ctl_get_flush_register.cfi_jt = . + 0x1b6d40;
		sde_hw_ctl_get_reset_status.cfi_jt = . + 0x1b6d48;
		sde_hw_ctl_clear_all_blendstages.cfi_jt = . + 0x1b6d50;
		sde_hw_ctl_setup_blendstage.cfi_jt = . + 0x1b6d58;
		sde_hw_ctl_get_staged_sspp.cfi_jt = . + 0x1b6d60;
		sde_hw_ctl_update_bitmask_sspp.cfi_jt = . + 0x1b6d68;
		sde_hw_ctl_update_bitmask_mixer.cfi_jt = . + 0x1b6d70;
		sde_hw_reg_dma_flush.cfi_jt = . + 0x1b6d78;
		sde_hw_ctl_update_bitmask_dspp_subblk.cfi_jt = . + 0x1b6d80;
		sde_hw_ctl_update_bitmask_dspp.cfi_jt = . + 0x1b6d88;
		sde_hw_ctl_update_bitmask_dspp_pavlut.cfi_jt = . + 0x1b6d90;
		sde_hw_ctl_hard_reset.cfi_jt = . + 0x1b6d98;
		sde_hw_ctl_uidle_enable.cfi_jt = . + 0x1b6da0;
		_sde_hw_setup_scaler3lite_lut.cfi_jt = . + 0x1b6da8;
		_sde_hw_setup_scaler3_lut.cfi_jt = . + 0x1b6db0;
		sde_hw_sspp_get_source_addr.cfi_jt = . + 0x1b6db8;
		sde_hw_sspp_setup_format.cfi_jt = . + 0x1b6dc0;
		sde_hw_sspp_setup_rects.cfi_jt = . + 0x1b6dc8;
		sde_hw_sspp_setup_sourceaddress.cfi_jt = . + 0x1b6dd0;
		sde_hw_sspp_setup_solidfill.cfi_jt = . + 0x1b6dd8;
		sde_hw_sspp_setup_pe_config.cfi_jt = . + 0x1b6de0;
		sde_hw_sspp_setup_secure.cfi_jt = . + 0x1b6de8;
		sde_hw_sspp_set_src_split_order.cfi_jt = . + 0x1b6df0;
		_sde_hw_sspp_setup_excl_rect.cfi_jt = . + 0x1b6df8;
		sde_hw_sspp_setup_qos_lut.cfi_jt = . + 0x1b6e00;
		sde_hw_sspp_setup_qos_ctrl.cfi_jt = . + 0x1b6e08;
		sde_hw_sspp_setup_ts_prefill.cfi_jt = . + 0x1b6e10;
		sde_hw_sspp_setup_csc.cfi_jt = . + 0x1b6e18;
		sde_hw_sspp_setup_dgm_csc.cfi_jt = . + 0x1b6e20;
		sde_hw_sspp_setup_sharpening.cfi_jt = . + 0x1b6e28;
		sde_hw_sspp_update_multirect.cfi_jt = . + 0x1b6e30;
		reg_dmav1_setup_vig_qseed3.cfi_jt = . + 0x1b6e38;
		_sde_hw_sspp_setup_scaler.cfi_jt = . + 0x1b6e40;
		_sde_hw_sspp_setup_scaler3.cfi_jt = . + 0x1b6e48;
		sde_hw_sspp_get_meta_error.cfi_jt = . + 0x1b6e50;
		sde_hw_sspp_get_ubwc_error_v1.cfi_jt = . + 0x1b6e58;
		sde_hw_sspp_get_ubwc_error.cfi_jt = . + 0x1b6e60;
		sde_hw_sspp_clear_meta_error.cfi_jt = . + 0x1b6e68;
		sde_hw_sspp_clear_ubwc_error_v1.cfi_jt = . + 0x1b6e70;
		sde_hw_sspp_clear_ubwc_error.cfi_jt = . + 0x1b6e78;
		sde_hw_sspp_setup_pre_downscale.cfi_jt = . + 0x1b6e80;
		sde_hw_sspp_setup_sys_cache.cfi_jt = . + 0x1b6e88;
		sde_hw_sspp_setup_cdp.cfi_jt = . + 0x1b6e90;
		sde_hw_sspp_setup_uidle.cfi_jt = . + 0x1b6e98;
		sde_hw_sspp_setup_dgm_inverse_pma.cfi_jt = . + 0x1b6ea0;
		sde_hw_sspp_setup_inverse_pma.cfi_jt = . + 0x1b6ea8;
		sde_hw_sspp_ubwc_stats_set_roi.cfi_jt = . + 0x1b6eb0;
		sde_hw_sspp_ubwc_stats_get_data.cfi_jt = . + 0x1b6eb8;
		sde_hw_wb_setup_outaddress.cfi_jt = . + 0x1b6ec0;
		sde_hw_wb_setup_format.cfi_jt = . + 0x1b6ec8;
		sde_hw_wb_roi.cfi_jt = . + 0x1b6ed0;
		sde_hw_wb_crop.cfi_jt = . + 0x1b6ed8;
		sde_hw_wb_setup_qos_lut.cfi_jt = . + 0x1b6ee0;
		sde_hw_wb_setup_cdp.cfi_jt = . + 0x1b6ee8;
		sde_hw_wb_program_cwb_ctrl.cfi_jt = . + 0x1b6ef0;
		sde_hw_wb_program_dcwb_ctrl.cfi_jt = . + 0x1b6ef8;
		sde_hw_wb_bind_pingpong_blk.cfi_jt = . + 0x1b6f00;
		sde_hw_wb_bind_dcwb_pp_blk.cfi_jt = . + 0x1b6f08;
		sde_hw_wb_program_cwb_dither_ctrl.cfi_jt = . + 0x1b6f10;
		sde_hw_sspp_get_clk_ctrl_status.cfi_jt = . + 0x1b6f18;
		sde_hw_wb_get_clk_ctrl_status.cfi_jt = . + 0x1b6f20;
		sde_hw_sspp_setup_clk_force_ctrl.cfi_jt = . + 0x1b6f28;
		sde_hw_wb_setup_clk_force_ctrl.cfi_jt = . + 0x1b6f30;
		_sde_hw_merge_3d_setup_blend_mode.cfi_jt = . + 0x1b6f38;
		sde_hw_merge_3d_reset_blend_mode.cfi_jt = . + 0x1b6f40;
		sde_hw_pp_get_caps.cfi_jt = . + 0x1b6f48;
		sde_hw_pp_setup_te_config.cfi_jt = . + 0x1b6f50;
		sde_hw_pp_update_te.cfi_jt = . + 0x1b6f58;
		sde_hw_pp_enable_te.cfi_jt = . + 0x1b6f60;
		sde_hw_pp_connect_external_te.cfi_jt = . + 0x1b6f68;
		sde_hw_pp_get_vsync_info.cfi_jt = . + 0x1b6f70;
		sde_hw_pp_setup_autorefresh_config.cfi_jt = . + 0x1b6f78;
		sde_hw_pp_get_autorefresh_config.cfi_jt = . + 0x1b6f80;
		sde_hw_pp_poll_timeout_wr_ptr.cfi_jt = . + 0x1b6f88;
		sde_hw_pp_get_line_count.cfi_jt = . + 0x1b6f90;
		sde_hw_pp_setup_dsc.cfi_jt = . + 0x1b6f98;
		sde_hw_pp_setup_dither.cfi_jt = . + 0x1b6fa0;
		sde_hw_pp_setup_3d_merge_mode.cfi_jt = . + 0x1b6fa8;
		sde_hw_pp_dsc_enable.cfi_jt = . + 0x1b6fb0;
		sde_hw_pp_dsc_disable.cfi_jt = . + 0x1b6fb8;
		sde_hw_pp_reset_3d_merge_mode.cfi_jt = . + 0x1b6fc0;
		sde_hw_reset_ubwc.cfi_jt = . + 0x1b6fc8;
		sde_hw_setup_split_pipe.cfi_jt = . + 0x1b6fd0;
		sde_hw_setup_pp_split.cfi_jt = . + 0x1b6fd8;
		sde_hw_setup_cdm_output.cfi_jt = . + 0x1b6fe0;
		sde_hw_setup_clk_force_ctrl.cfi_jt = . + 0x1b6fe8;
		sde_hw_get_clk_ctrl_status.cfi_jt = . + 0x1b6ff0;
		sde_hw_program_cwb_ppb_ctrl.cfi_jt = . + 0x1b6ff8;
		sde_hw_intf_audio_select.cfi_jt = . + 0x1b7000;
		sde_hw_mdp_events.cfi_jt = . + 0x1b7008;
		sde_hw_setup_vsync_source.cfi_jt = . + 0x1b7010;
		sde_hw_setup_vsync_source_v1.cfi_jt = . + 0x1b7018;
		sde_hw_set_hdr_plus_metadata.cfi_jt = . + 0x1b7020;
		sde_hw_get_autorefresh_status.cfi_jt = . + 0x1b7028;
		sde_hw_intr_irqidx_lookup.cfi_jt = . + 0x1b7030;
		sde_hw_intr_enable_irq_nolock.cfi_jt = . + 0x1b7038;
		sde_hw_intr_disable_irq_nolock.cfi_jt = . + 0x1b7040;
		sde_hw_intr_dispatch_irq.cfi_jt = . + 0x1b7048;
		sde_hw_intr_clear_irqs.cfi_jt = . + 0x1b7050;
		sde_hw_intr_disable_irqs.cfi_jt = . + 0x1b7058;
		sde_hw_intr_get_interrupt_sources.cfi_jt = . + 0x1b7060;
		sde_hw_intr_get_interrupt_statuses.cfi_jt = . + 0x1b7068;
		sde_hw_intr_clear_interrupt_status.cfi_jt = . + 0x1b7070;
		sde_hw_intr_clear_intr_status_nolock.cfi_jt = . + 0x1b7078;
		sde_hw_intr_get_interrupt_status.cfi_jt = . + 0x1b7080;
		sde_hw_intr_get_intr_status_nolock.cfi_jt = . + 0x1b7088;
		sde_hw_set_limit_conf.cfi_jt = . + 0x1b7090;
		sde_hw_get_limit_conf.cfi_jt = . + 0x1b7098;
		sde_hw_set_axi_halt.cfi_jt = . + 0x1b70a0;
		sde_hw_get_axi_halt_status.cfi_jt = . + 0x1b70a8;
		sde_hw_set_xin_halt.cfi_jt = . + 0x1b70b0;
		sde_hw_get_xin_halt_status.cfi_jt = . + 0x1b70b8;
		sde_hw_set_qos_remap.cfi_jt = . + 0x1b70c0;
		sde_hw_set_mem_type.cfi_jt = . + 0x1b70c8;
		sde_hw_set_mem_type_v1.cfi_jt = . + 0x1b70d0;
		sde_hw_clear_errors.cfi_jt = . + 0x1b70d8;
		sde_hw_set_write_gather_en.cfi_jt = . + 0x1b70e0;
		sde_format_check_modified_format.cfi_jt = . + 0x1b70e8;
		sde_get_msm_format.cfi_jt = . + 0x1b70f0;
		dp_display_mmrm_callback.cfi_jt = . + 0x1b70f8;
		sde_power_mmrm_callback.cfi_jt = . + 0x1b7100;
		reg_dmav1_setup_vig_gamutv5.cfi_jt = . + 0x1b7108;
		reg_dmav1_setup_vig_gamutv6.cfi_jt = . + 0x1b7110;
		reg_dmav1_setup_vig_igcv5.cfi_jt = . + 0x1b7118;
		reg_dmav1_setup_vig_igcv6.cfi_jt = . + 0x1b7120;
		reg_dmav2_setup_vig_gamutv61.cfi_jt = . + 0x1b7128;
		sde_setup_pipe_pa_hue_v1_7.cfi_jt = . + 0x1b7130;
		sde_setup_pipe_pa_sat_v1_7.cfi_jt = . + 0x1b7138;
		sde_setup_pipe_pa_val_v1_7.cfi_jt = . + 0x1b7140;
		sde_setup_pipe_pa_cont_v1_7.cfi_jt = . + 0x1b7148;
		sde_setup_pipe_pa_memcol_v1_7.cfi_jt = . + 0x1b7150;
		reg_dmav1_setup_dspp_vlutv18.cfi_jt = . + 0x1b7158;
		reg_dmav1_setup_dspp_3d_gamutv4.cfi_jt = . + 0x1b7160;
		reg_dmav1_setup_dspp_3d_gamutv41.cfi_jt = . + 0x1b7168;
		reg_dmav1_setup_dspp_3d_gamutv42.cfi_jt = . + 0x1b7170;
		reg_dmav1_setup_dspp_gcv18.cfi_jt = . + 0x1b7178;
		reg_dmav1_setup_dspp_igcv31.cfi_jt = . + 0x1b7180;
		reg_dmav1_setup_dspp_pccv4.cfi_jt = . + 0x1b7188;
		reg_dmav1_setup_dspp_pccv5.cfi_jt = . + 0x1b7190;
		reg_dmav1_setup_dspp_pa_hsicv17.cfi_jt = . + 0x1b7198;
		reg_dmav1_setup_dspp_sixzonev17.cfi_jt = . + 0x1b71a0;
		reg_dmav1_setup_dspp_memcol_skinv17.cfi_jt = . + 0x1b71a8;
		reg_dmav1_setup_dspp_memcol_skyv17.cfi_jt = . + 0x1b71b0;
		reg_dmav1_setup_dspp_memcol_folv17.cfi_jt = . + 0x1b71b8;
		reg_dmav1_setup_dspp_memcol_protv17.cfi_jt = . + 0x1b71c0;
		reg_dmav1_setup_ltm_initv1.cfi_jt = . + 0x1b71c8;
		reg_dmav1_setup_ltm_roiv1.cfi_jt = . + 0x1b71d0;
		reg_dmav1_setup_ltm_vlutv1.cfi_jt = . + 0x1b71d8;
		reg_dmav2_setup_dspp_igcv4.cfi_jt = . + 0x1b71e0;
		reg_dmav2_setup_dspp_3d_gamutv43.cfi_jt = . + 0x1b71e8;
		reg_dmav1_setup_spr_init_cfgv1.cfi_jt = . + 0x1b71f0;
		reg_dmav1_setup_spr_pu_cfgv1.cfi_jt = . + 0x1b71f8;
		reg_dmav1_setup_demurav1.cfi_jt = . + 0x1b7200;
		sde_setup_dspp_3d_gamutv4.cfi_jt = . + 0x1b7208;
		sde_setup_dspp_3d_gamutv41.cfi_jt = . + 0x1b7210;
		sde_setup_dspp_igcv3.cfi_jt = . + 0x1b7218;
		sde_setup_dspp_pccv4.cfi_jt = . + 0x1b7220;
		sde_setup_dspp_ltm_threshv1.cfi_jt = . + 0x1b7228;
		sde_demura_pu_cfg.cfi_jt = . + 0x1b7230;
		sde_setup_dspp_ad4.cfi_jt = . + 0x1b7238;
		sde_setup_dspp_pa_hsic_v17.cfi_jt = . + 0x1b7240;
		sde_setup_dspp_sixzone_v17.cfi_jt = . + 0x1b7248;
		sde_setup_dspp_memcol_skin_v17.cfi_jt = . + 0x1b7250;
		sde_setup_dspp_memcol_sky_v17.cfi_jt = . + 0x1b7258;
		sde_setup_dspp_memcol_foliage_v17.cfi_jt = . + 0x1b7260;
		sde_setup_dspp_memcol_prot_v17.cfi_jt = . + 0x1b7268;
		sde_setup_dspp_pcc_v1_7.cfi_jt = . + 0x1b7270;
		sde_setup_dspp_pa_vlut_v1_7.cfi_jt = . + 0x1b7278;
		sde_setup_dspp_pa_vlut_v1_8.cfi_jt = . + 0x1b7280;
		sde_setup_dspp_gc_v1_7.cfi_jt = . + 0x1b7288;
		sde_setup_dspp_hist_v1_7.cfi_jt = . + 0x1b7290;
		sde_read_dspp_hist_v1_7.cfi_jt = . + 0x1b7298;
		sde_lock_dspp_hist_v1_7.cfi_jt = . + 0x1b72a0;
		sde_setup_dspp_dither_v1_7.cfi_jt = . + 0x1b72a8;
		default_alloc_reg_dma_buf.cfi_jt = . + 0x1b72b0;
		alloc_reg_dma_buf_v1.cfi_jt = . + 0x1b72b8;
		default_check_support.cfi_jt = . + 0x1b72c0;
		check_support_v1.cfi_jt = . + 0x1b72c8;
		default_kick_off.cfi_jt = . + 0x1b72d0;
		kick_off_v1.cfi_jt = . + 0x1b72d8;
		sde_hw_ctl_trigger_flush.cfi_jt = . + 0x1b72e0;
		sde_hw_ctl_trigger_flush_v1.cfi_jt = . + 0x1b72e8;
		sde_hw_ctl_clear_pending_flush.cfi_jt = . + 0x1b72f0;
		sde_hw_ctl_trigger_start.cfi_jt = . + 0x1b72f8;
		sde_hw_ctl_trigger_pending.cfi_jt = . + 0x1b7300;
		sde_hw_ctl_reset_control.cfi_jt = . + 0x1b7308;
		sde_hw_ctl_wait_reset_status.cfi_jt = . + 0x1b7310;
		sde_hw_ctl_get_start_state.cfi_jt = . + 0x1b7318;
		default_reset.cfi_jt = . + 0x1b7320;
		reset_v1.cfi_jt = . + 0x1b7328;
		default_dealloc_reg_dma.cfi_jt = . + 0x1b7330;
		default_buf_reset_reg_dma.cfi_jt = . + 0x1b7338;
		dealloc_reg_dma_v1.cfi_jt = . + 0x1b7340;
		reset_reg_dma_buffer_v1.cfi_jt = . + 0x1b7348;
		default_setup_payload.cfi_jt = . + 0x1b7350;
		setup_payload_v1.cfi_jt = . + 0x1b7358;
		write_decode_sel.cfi_jt = . + 0x1b7360;
		validate_write_reg.cfi_jt = . + 0x1b7368;
		write_single_reg.cfi_jt = . + 0x1b7370;
		write_multi_reg_inc.cfi_jt = . + 0x1b7378;
		write_multi_reg_index.cfi_jt = . + 0x1b7380;
		write_multi_lut_reg.cfi_jt = . + 0x1b7388;
		write_single_modify.cfi_jt = . + 0x1b7390;
		write_block_lut_reg.cfi_jt = . + 0x1b7398;
		validate_write_decode_sel.cfi_jt = . + 0x1b73a0;
		validate_write_multi_lut_reg.cfi_jt = . + 0x1b73a8;
		validate_blk_lut_write.cfi_jt = . + 0x1b73b0;
		default_last_command.cfi_jt = . + 0x1b73b8;
		default_last_command_sb.cfi_jt = . + 0x1b73c0;
		last_cmd_v1.cfi_jt = . + 0x1b73c8;
		last_cmd_sb_v2.cfi_jt = . + 0x1b73d0;
		sde_hw_dsc_disable.cfi_jt = . + 0x1b73d8;
		sde_hw_dsc_disable.7663.cfi_jt = . + 0x1b73e0;
		sde_hw_dsc_config.cfi_jt = . + 0x1b73e8;
		sde_hw_dsc_config.7664.cfi_jt = . + 0x1b73f0;
		sde_hw_dsc_config_thresh.cfi_jt = . + 0x1b73f8;
		sde_hw_dsc_config_thresh.7665.cfi_jt = . + 0x1b7400;
		sde_hw_dsc_bind_pingpong_blk.cfi_jt = . + 0x1b7408;
		sde_hw_dsc_bind_pingpong_blk.7666.cfi_jt = . + 0x1b7410;
		sde_hw_vdc_disable.cfi_jt = . + 0x1b7418;
		sde_hw_vdc_config.cfi_jt = . + 0x1b7420;
		sde_hw_vdc_bind_pingpong_blk.cfi_jt = . + 0x1b7428;
		sde_hw_ds_setup_opmode.cfi_jt = . + 0x1b7430;
		sde_hw_ds_setup_scaler3.cfi_jt = . + 0x1b7438;
		sde_rot_fence_get_driver_name.cfi_jt = . + 0x1b7440;
		sde_rot_fence_get_timeline_name.cfi_jt = . + 0x1b7448;
		sde_fence_get_driver_name.cfi_jt = . + 0x1b7450;
		sde_fence_get_timeline_name.cfi_jt = . + 0x1b7458;
		sde_rot_fence_enable_signaling.cfi_jt = . + 0x1b7460;
		sde_rot_fence_signaled.cfi_jt = . + 0x1b7468;
		sde_fence_enable_signaling.cfi_jt = . + 0x1b7470;
		sde_fence_signaled.cfi_jt = . + 0x1b7478;
		sde_rot_fence_release.cfi_jt = . + 0x1b7480;
		sde_fence_release.cfi_jt = . + 0x1b7488;
		sde_rot_fence_value_str.cfi_jt = . + 0x1b7490;
		sde_rot_fence_timeline_value_str.cfi_jt = . + 0x1b7498;
		sde_fence_value_str.cfi_jt = . + 0x1b74a0;
		sde_fence_timeline_value_str.cfi_jt = . + 0x1b74a8;
		sde_hw_qdss_enable_qdss_events.cfi_jt = . + 0x1b74b0;
		sde_hw_rc_check_mask.cfi_jt = . + 0x1b74b8;
		sde_hw_rc_check_pu_roi.cfi_jt = . + 0x1b74c0;
		sde_hw_rc_setup_pu_roi.cfi_jt = . + 0x1b74c8;
		sde_hw_rc_setup_mask.cfi_jt = . + 0x1b74d0;
		sde_hw_rc_setup_data_dma.cfi_jt = . + 0x1b74d8;
		sde_hw_rc_setup_data_ahb.cfi_jt = . + 0x1b74e0;
		sde_wb_connector_set_property.cfi_jt = . + 0x1b74e8;
		dp_connector_set_colorspace.cfi_jt = . + 0x1b74f0;
		dp_connector_post_init.cfi_jt = . + 0x1b74f8;
		dp_mst_connector_post_init.cfi_jt = . + 0x1b7500;
		sde_wb_connector_post_init.cfi_jt = . + 0x1b7508;
		sde_encoder_phys_wb_late_register.cfi_jt = . + 0x1b7510;
		sde_encoder_phys_vid_is_master.cfi_jt = . + 0x1b7518;
		sde_encoder_phys_needs_single_flush.cfi_jt = . + 0x1b7520;
		sde_encoder_phys_vid_wait_dma_trigger.cfi_jt = . + 0x1b7528;
		sde_encoder_phys_cmd_is_master.cfi_jt = . + 0x1b7530;
		sde_encoder_phys_needs_single_flush.4233.cfi_jt = . + 0x1b7538;
		sde_encoder_phys_cmd_is_autorefresh_enabled.cfi_jt = . + 0x1b7540;
		sde_encoder_phys_wb_is_master.cfi_jt = . + 0x1b7548;
		sde_encoder_phys_vid_mode_set.cfi_jt = . + 0x1b7550;
		sde_encoder_phys_cmd_mode_set.cfi_jt = . + 0x1b7558;
		sde_encoder_phys_wb_mode_set.cfi_jt = . + 0x1b7560;
		sde_encoder_phys_wb_atomic_check.cfi_jt = . + 0x1b7568;
		sde_encoder_phys_vid_get_hw_resources.cfi_jt = . + 0x1b7570;
		sde_encoder_phys_cmd_get_hw_resources.cfi_jt = . + 0x1b7578;
		sde_encoder_phys_wb_get_hw_resources.cfi_jt = . + 0x1b7580;
		sde_encoder_phys_vid_wait_for_commit_done.cfi_jt = . + 0x1b7588;
		sde_encoder_phys_vid_wait_for_vblank_no_notify.cfi_jt = . + 0x1b7590;
		sde_encoder_phys_vid_wait_for_vblank.cfi_jt = . + 0x1b7598;
		sde_encoder_phys_vid_get_line_count.cfi_jt = . + 0x1b75a0;
		sde_encoder_phys_vid_wait_for_active.cfi_jt = . + 0x1b75a8;
		sde_encoder_phys_cmd_wait_for_commit_done.cfi_jt = . + 0x1b75b0;
		sde_encoder_phys_cmd_wait_for_tx_complete.cfi_jt = . + 0x1b75b8;
		sde_encoder_phys_cmd_wait_for_vblank.cfi_jt = . + 0x1b75c0;
		sde_encoder_phys_cmd_te_get_line_count.cfi_jt = . + 0x1b75c8;
		sde_encoder_phys_wb_wait_for_commit_done.cfi_jt = . + 0x1b75d0;
		sde_encoder_phys_wb_wait_for_tx_complete.cfi_jt = . + 0x1b75d8;
		sde_encoder_phys_vid_prepare_for_kickoff.cfi_jt = . + 0x1b75e0;
		sde_encoder_phys_cmd_prepare_for_kickoff.cfi_jt = . + 0x1b75e8;
		sde_encoder_phys_wb_prepare_for_kickoff.cfi_jt = . + 0x1b75f0;
		sde_encoder_helper_trigger_flush.cfi_jt = . + 0x1b75f8;
		sde_encoder_helper_trigger_start.cfi_jt = . + 0x1b7600;
		sde_encoder_helper_hw_reset.cfi_jt = . + 0x1b7608;
		sde_encoder_phys_vid_add_enc_to_minidump.cfi_jt = . + 0x1b7610;
		sde_encoder_phys_vid_enable.cfi_jt = . + 0x1b7618;
		sde_encoder_phys_vid_disable.cfi_jt = . + 0x1b7620;
		sde_encoder_phys_vid_destroy.cfi_jt = . + 0x1b7628;
		sde_encoder_phys_vid_handle_post_kickoff.cfi_jt = . + 0x1b7630;
		sde_encoder_phys_vid_prepare_for_commit.cfi_jt = . + 0x1b7638;
		sde_encoder_phys_cmd_add_enc_to_minidump.cfi_jt = . + 0x1b7640;
		sde_encoder_phys_cmd_prepare_commit.cfi_jt = . + 0x1b7648;
		sde_encoder_phys_cmd_enable.cfi_jt = . + 0x1b7650;
		sde_encoder_phys_cmd_disable.cfi_jt = . + 0x1b7658;
		sde_encoder_phys_cmd_destroy.cfi_jt = . + 0x1b7660;
		sde_encoder_phys_cmd_trigger_start.cfi_jt = . + 0x1b7668;
		sde_encoder_phys_cmd_enable_helper.cfi_jt = . + 0x1b7670;
		_sde_encoder_phys_disable_autorefresh.cfi_jt = . + 0x1b7678;
		sde_encoder_phys_wb_add_enc_to_minidump.cfi_jt = . + 0x1b7680;
		sde_encoder_phys_wb_enable.cfi_jt = . + 0x1b7688;
		sde_encoder_phys_wb_disable.cfi_jt = . + 0x1b7690;
		sde_encoder_phys_wb_destroy.cfi_jt = . + 0x1b7698;
		sde_encoder_phys_wb_handle_post_kickoff.cfi_jt = . + 0x1b76a0;
		sde_encoder_phys_wb_trigger_flush.cfi_jt = . + 0x1b76a8;
		sde_encoder_phys_vid_irq_control.cfi_jt = . + 0x1b76b0;
		sde_encoder_phys_cmd_irq_control.cfi_jt = . + 0x1b76b8;
		sde_encoder_phys_cmd_connect_te.cfi_jt = . + 0x1b76c0;
		sde_encoder_phys_wb_irq_ctrl.cfi_jt = . + 0x1b76c8;
		sde_encoder_phys_vid_vblank_irq.cfi_jt = . + 0x1b76d0;
		sde_encoder_phys_vid_underrun_irq.cfi_jt = . + 0x1b76d8;
		sde_encoder_phys_cmd_pp_tx_done_irq.cfi_jt = . + 0x1b76e0;
		sde_encoder_phys_cmd_te_rd_ptr_irq.cfi_jt = . + 0x1b76e8;
		sde_encoder_phys_cmd_autorefresh_done_irq.cfi_jt = . + 0x1b76f0;
		sde_encoder_phys_cmd_wr_ptr_irq.cfi_jt = . + 0x1b76f8;
		sde_core_irq_callback_handler.cfi_jt = . + 0x1b7700;
		_sde_cp_ad_interrupt_cb.cfi_jt = . + 0x1b7708;
		_sde_cp_hist_interrupt_cb.cfi_jt = . + 0x1b7710;
		_sde_cp_ltm_hist_interrupt_cb.cfi_jt = . + 0x1b7718;
		_sde_cp_ltm_wb_pb_interrupt_cb.cfi_jt = . + 0x1b7720;
		sde_encoder_phys_wb_done_irq.cfi_jt = . + 0x1b7728;
		sde_encoder_phys_cwb_ovflow.cfi_jt = . + 0x1b7730;
		sde_rsc_unregister_event.cfi_jt = . + 0x1b7738;
		sde_rsc_register_event.cfi_jt = . + 0x1b7740;
		sde_rsc_client_vote.cfi_jt = . + 0x1b7748;
		sde_rsc_client_trigger_vote.cfi_jt = . + 0x1b7750;
		sde_rsc_client_state_update.cfi_jt = . + 0x1b7758;
		sde_rsc_client_destroy.cfi_jt = . + 0x1b7760;
		sde_rsc_client_create.cfi_jt = . + 0x1b7768;
		is_sde_rsc_available.cfi_jt = . + 0x1b7770;
		get_sde_rsc_current_state.cfi_jt = . + 0x1b7778;
		rsc_hw_mode_ctrl.cfi_jt = . + 0x1b7780;
		sde_rsc_debug_show.cfi_jt = . + 0x1b7788;
		rsc_hw_vsync.cfi_jt = . + 0x1b7790;
		rsc_hw_debug_dump.cfi_jt = . + 0x1b7798;
		rsc_hw_is_amc_mode.cfi_jt = . + 0x1b77a0;
		sde_rsc_state_update.cfi_jt = . + 0x1b77a8;
		sde_rsc_state_update_v3.cfi_jt = . + 0x1b77b0;
		rsc_hw_init.cfi_jt = . + 0x1b77b8;
		rsc_hw_tcs_wait.cfi_jt = . + 0x1b77c0;
		rsc_hw_tcs_use_ok.cfi_jt = . + 0x1b77c8;
		rsc_hw_timer_update.cfi_jt = . + 0x1b77d0;
		rsc_hw_init_v3.cfi_jt = . + 0x1b77d8;
		rsc_hw_timer_update_v3.cfi_jt = . + 0x1b77e0;
		rsc_hw_bwi_status_v3.cfi_jt = . + 0x1b77e8;
		rsc_hw_profiling_counter_ctrl.cfi_jt = . + 0x1b77f0;
		rsc_hw_get_profiling_counter_status.cfi_jt = . + 0x1b77f8;
		dsi_phy_hw_v3_0_regulator_enable.cfi_jt = . + 0x1b7800;
		dsi_phy_hw_v4_0_commit_phy_timing.cfi_jt = . + 0x1b7808;
		dsi_phy_hw_v3_0_enable.cfi_jt = . + 0x1b7810;
		dsi_phy_hw_v3_0_disable.cfi_jt = . + 0x1b7818;
		dsi_phy_hw_v4_0_enable.cfi_jt = . + 0x1b7820;
		dsi_phy_hw_v4_0_disable.cfi_jt = . + 0x1b7828;
		dsi_phy_hw_v3_0_regulator_disable.cfi_jt = . + 0x1b7830;
		dsi_phy_hw_v3_0_toggle_resync_fifo.cfi_jt = . + 0x1b7838;
		dsi_phy_hw_v4_0_toggle_resync_fifo.cfi_jt = . + 0x1b7840;
		dsi_phy_hw_v4_0_reset_clk_en_sel.cfi_jt = . + 0x1b7848;
		dsi_phy_hw_v3_0_wait_for_lane_idle.cfi_jt = . + 0x1b7850;
		dsi_phy_hw_v4_0_wait_for_lane_idle.cfi_jt = . + 0x1b7858;
		dsi_phy_hw_v3_0_lane_reset.cfi_jt = . + 0x1b7860;
		dsi_phy_hw_v4_0_lane_reset.cfi_jt = . + 0x1b7868;
		dsi_phy_hw_v3_0_ulps_request.cfi_jt = . + 0x1b7870;
		dsi_phy_hw_v3_0_ulps_exit.cfi_jt = . + 0x1b7878;
		dsi_phy_hw_v4_0_ulps_request.cfi_jt = . + 0x1b7880;
		dsi_phy_hw_v4_0_ulps_exit.cfi_jt = . + 0x1b7888;
		dsi_phy_hw_v3_0_get_lanes_in_ulps.cfi_jt = . + 0x1b7890;
		dsi_phy_hw_v4_0_get_lanes_in_ulps.cfi_jt = . + 0x1b7898;
		dsi_phy_hw_v3_0_is_lanes_in_ulps.cfi_jt = . + 0x1b78a0;
		dsi_phy_hw_v4_0_is_lanes_in_ulps.cfi_jt = . + 0x1b78a8;
		dsi_phy_hw_v3_0_dyn_refresh_config.cfi_jt = . + 0x1b78b0;
		dsi_phy_hw_v4_0_dyn_refresh_config.cfi_jt = . + 0x1b78b8;
		dsi_phy_hw_v3_0_dyn_refresh_pipe_delay.cfi_jt = . + 0x1b78c0;
		dsi_phy_hw_v4_0_dyn_refresh_pipe_delay.cfi_jt = . + 0x1b78c8;
		dsi_phy_hw_v3_0_dyn_refresh_helper.cfi_jt = . + 0x1b78d0;
		dsi_phy_hw_v4_0_dyn_refresh_helper.cfi_jt = . + 0x1b78d8;
		dsi_phy_hw_timing_val_v3_0.cfi_jt = . + 0x1b78e0;
		dsi_phy_hw_v3_0_cache_phy_timings.cfi_jt = . + 0x1b78e8;
		dsi_phy_hw_timing_val_v4_0.cfi_jt = . + 0x1b78f0;
		dsi_phy_hw_v4_0_cache_phy_timings.cfi_jt = . + 0x1b78f8;
		dsi_phy_hw_v3_0_clamp_ctrl.cfi_jt = . + 0x1b7900;
		dsi_phy_hw_v4_0_dyn_refresh_trigger_sel.cfi_jt = . + 0x1b7908;
		dsi_phy_hw_v4_0_set_continuous_clk.cfi_jt = . + 0x1b7910;
		dsi_phy_hw_calculate_timing_params.cfi_jt = . + 0x1b7918;
		dsi_phy_hw_v3_0_get_default_phy_params.cfi_jt = . + 0x1b7920;
		dsi_phy_hw_v4_0_get_default_phy_params.cfi_jt = . + 0x1b7928;
		dsi_phy_hw_v3_0_calc_clk_trail_rec_min.cfi_jt = . + 0x1b7930;
		dsi_phy_hw_v4_0_calc_clk_trail_rec_min.cfi_jt = . + 0x1b7938;
		dsi_phy_hw_v3_0_calc_clk_zero.cfi_jt = . + 0x1b7940;
		dsi_phy_hw_v3_0_calc_clk_trail_rec_max.cfi_jt = . + 0x1b7948;
		dsi_phy_hw_v3_0_calc_hs_zero.cfi_jt = . + 0x1b7950;
		dsi_phy_hw_v4_0_calc_clk_zero.cfi_jt = . + 0x1b7958;
		dsi_phy_hw_v4_0_calc_clk_trail_rec_max.cfi_jt = . + 0x1b7960;
		dsi_phy_hw_v4_0_calc_hs_zero.cfi_jt = . + 0x1b7968;
		dsi_phy_hw_v3_0_calc_hs_trail.cfi_jt = . + 0x1b7970;
		dsi_phy_hw_v4_0_calc_hs_trail.cfi_jt = . + 0x1b7978;
		dsi_phy_hw_v3_0_update_timing_params.cfi_jt = . + 0x1b7980;
		dsi_phy_hw_v4_0_update_timing_params.cfi_jt = . + 0x1b7988;
		dsi_pll_prepare_stub.cfi_jt = . + 0x1b7990;
		dsi_pll_unprepare_stub.cfi_jt = . + 0x1b7998;
		dsi_pll_set_rate_stub.cfi_jt = . + 0x1b79a0;
		dp_pll_vco_div_clk_recalc_rate.cfi_jt = . + 0x1b79a8;
		dp_pll_link_clk_recalc_rate.cfi_jt = . + 0x1b79b0;
		dp_pll_vco_div_clk_recalc_rate.3146.cfi_jt = . + 0x1b79b8;
		dp_pll_link_clk_recalc_rate.3151.cfi_jt = . + 0x1b79c0;
		dsi_pll_pclk_recalc_rate.cfi_jt = . + 0x1b79c8;
		dsi_pll_byteclk_recalc_rate.cfi_jt = . + 0x1b79d0;
		dp_pll_vco_div_clk_round.cfi_jt = . + 0x1b79d8;
		dp_pll_link_clk_round.cfi_jt = . + 0x1b79e0;
		dp_pll_vco_div_clk_round.3147.cfi_jt = . + 0x1b79e8;
		dp_pll_link_clk_round.3152.cfi_jt = . + 0x1b79f0;
		dsi_pll_pclk_round_rate.cfi_jt = . + 0x1b79f8;
		dsi_pll_byteclk_round_rate.cfi_jt = . + 0x1b7a00;
		dsi_ctrl_hw_cmn_setup_misr.cfi_jt = . + 0x1b7a08;
		dsi_ctrl_hw_cmn_collect_misr.cfi_jt = . + 0x1b7a10;
		dsi_ctrl_hw_cmn_set_video_timing.cfi_jt = . + 0x1b7a18;
		dsi_ctrl_hw_cmn_setup_cmd_stream.cfi_jt = . + 0x1b7a20;
		dsi_ctrl_hw_cmn_video_engine_setup.cfi_jt = . + 0x1b7a28;
		dsi_ctrl_hw_cmn_cmd_engine_setup.cfi_jt = . + 0x1b7a30;
		dsi_ctrl_hw_cmn_kickoff_fifo_command.cfi_jt = . + 0x1b7a38;
		dsi_ctrl_hw_cmn_get_cmd_read_data.cfi_jt = . + 0x1b7a40;
		dsi_ctrl_hw_cmn_get_error_status.cfi_jt = . + 0x1b7a48;
		dsi_ctrl_hw_cmn_clear_error_status.cfi_jt = . + 0x1b7a50;
		dsi_ctrl_hw_cmn_enable_error_interrupts.cfi_jt = . + 0x1b7a58;
		dsi_ctrl_hw_cmn_video_test_pattern_setup.cfi_jt = . + 0x1b7a60;
		dsi_ctrl_hw_cmn_cmd_test_pattern_setup.cfi_jt = . + 0x1b7a68;
		dsi_ctrl_hw_cmn_ulps_request.cfi_jt = . + 0x1b7a70;
		dsi_ctrl_hw_cmn_ulps_exit.cfi_jt = . + 0x1b7a78;
		dsi_ctrl_hw_cmn_clear_interrupt_status.cfi_jt = . + 0x1b7a80;
		dsi_ctrl_hw_cmn_enable_status_interrupts.cfi_jt = . + 0x1b7a88;
		dsi_ctrl_hw_cmn_trigger_cmd_test_pattern.cfi_jt = . + 0x1b7a90;
		dsi_ctrl_hw_cmn_phy_sw_reset.cfi_jt = . + 0x1b7a98;
		dsi_ctrl_hw_cmn_soft_reset.cfi_jt = . + 0x1b7aa0;
		dsi_ctrl_hw_cmn_reset_cmd_fifo.cfi_jt = . + 0x1b7aa8;
		dsi_ctrl_hw_cmn_trigger_command_dma.cfi_jt = . + 0x1b7ab0;
		dsi_ctrl_hw_cmn_clear_rdbk_reg.cfi_jt = . + 0x1b7ab8;
		dsi_ctrl_hw_dln0_phy_err.cfi_jt = . + 0x1b7ac0;
		dsi_ctrl_hw_cmn_ctrl_reset.cfi_jt = . + 0x1b7ac8;
		dsi_ctrl_hw_cmn_mask_error_intr.cfi_jt = . + 0x1b7ad0;
		dsi_ctrl_hw_cmn_get_lanes_in_ulps.cfi_jt = . + 0x1b7ad8;
		dsi_ctrl_hw_cmn_poll_dma_status.cfi_jt = . + 0x1b7ae0;
		dsi_ctrl_hw_cmn_get_interrupt_status.cfi_jt = . + 0x1b7ae8;
		dsi_ctrl_hw_cmn_get_error_mask.cfi_jt = . + 0x1b7af0;
		dsi_ctrl_hw_cmn_get_hw_version.cfi_jt = . + 0x1b7af8;
		dsi_ctrl_hw_cmn_wait_for_cmd_mode_mdp_idle.cfi_jt = . + 0x1b7b00;
		dsi_ctrl_hw_cmn_wait4dynamic_refresh_done.cfi_jt = . + 0x1b7b08;
		dsi_ctrl_hw_cmn_vid_engine_busy.cfi_jt = . + 0x1b7b10;
		dsi_ctrl_hw_22_setup_lane_map.cfi_jt = . + 0x1b7b18;
		dsi_ctrl_hw_22_wait_for_lane_idle.cfi_jt = . + 0x1b7b20;
		dsi_ctrl_hw_22_reg_dump_to_buffer.cfi_jt = . + 0x1b7b28;
		dsi_ctrl_hw_cmn_set_timing_db.cfi_jt = . + 0x1b7b30;
		dsi_ctrl_hw_cmn_setup_avr.cfi_jt = . + 0x1b7b38;
		dsi_ctrl_hw_cmn_video_engine_en.cfi_jt = . + 0x1b7b40;
		dsi_ctrl_hw_cmn_ctrl_en.cfi_jt = . + 0x1b7b48;
		dsi_ctrl_hw_cmn_cmd_engine_en.cfi_jt = . + 0x1b7b50;
		dsi_ctrl_hw_cmn_test_pattern_enable.cfi_jt = . + 0x1b7b58;
		dsi_ctrl_hw_cmn_error_intr_ctrl.cfi_jt = . + 0x1b7b60;
		dsi_ctrl_hw_cmn_hs_req_sel.cfi_jt = . + 0x1b7b68;
		dsi_ctrl_hw_cmn_set_continuous_clk.cfi_jt = . + 0x1b7b70;
		dsi_ctrl_hw_22_phy_reset_config.cfi_jt = . + 0x1b7b78;
		dsi_ctrl_hw_22_schedule_dma_cmd.cfi_jt = . + 0x1b7b80;
		dsi_ctrl_hw_cmn_kickoff_command.cfi_jt = . + 0x1b7b88;
		dsi_ctrl_hw_kickoff_non_embedded_mode.cfi_jt = . + 0x1b7b90;
		dsi_ctrl_hw_22_config_clk_gating.cfi_jt = . + 0x1b7b98;
		dsi_ctrl_hw_22_configure_cmddma_window.cfi_jt = . + 0x1b7ba0;
		dsi_ctrl_hw_cmn_host_setup.cfi_jt = . + 0x1b7ba8;
		dsi_ctrl_hw_cmn_init_cmddma_trig_ctrl.cfi_jt = . + 0x1b7bb0;
		dsi_ctrl_hw_22_reset_trigger_controls.cfi_jt = . + 0x1b7bb8;
		dsi_ctrl_hw_22_log_line_count.cfi_jt = . + 0x1b7bc0;
		dsi_ctrl_hw_22_configure_splitlink.cfi_jt = . + 0x1b7bc8;
		dsi_conn_get_lm_from_mode.cfi_jt = . + 0x1b7bd0;
		dsi_conn_get_qsync_min_fps.cfi_jt = . + 0x1b7bd8;
		dp_connnector_set_info_blob.cfi_jt = . + 0x1b7be0;
		dp_mst_fixed_connnector_set_info_blob.cfi_jt = . + 0x1b7be8;
		sde_wb_connector_set_info_blob.cfi_jt = . + 0x1b7bf0;
		dsi_conn_set_info_blob.cfi_jt = . + 0x1b7bf8;
		dsi_conn_set_submode_blob_info.cfi_jt = . + 0x1b7c00;
		dsi_conn_pre_kickoff.cfi_jt = . + 0x1b7c08;
		dsi_conn_prepare_commit.cfi_jt = . + 0x1b7c10;
		dsi_conn_enable_event.cfi_jt = . + 0x1b7c18;
		dsi_conn_post_kickoff.cfi_jt = . + 0x1b7c20;
		dp_bridge_attach.cfi_jt = . + 0x1b7c28;
		dp_mst_bridge_attach.cfi_jt = . + 0x1b7c30;
		dsi_bridge_attach.cfi_jt = . + 0x1b7c38;
		dp_bridge_disable.cfi_jt = . + 0x1b7c40;
		dp_bridge_post_disable.cfi_jt = . + 0x1b7c48;
		dp_bridge_pre_enable.cfi_jt = . + 0x1b7c50;
		dp_bridge_enable.cfi_jt = . + 0x1b7c58;
		dp_mst_bridge_disable.cfi_jt = . + 0x1b7c60;
		dp_mst_bridge_post_disable.cfi_jt = . + 0x1b7c68;
		dp_mst_bridge_pre_enable.cfi_jt = . + 0x1b7c70;
		dp_mst_bridge_enable.cfi_jt = . + 0x1b7c78;
		dsi_bridge_disable.cfi_jt = . + 0x1b7c80;
		dsi_bridge_post_disable.cfi_jt = . + 0x1b7c88;
		dsi_bridge_pre_enable.cfi_jt = . + 0x1b7c90;
		dsi_bridge_enable.cfi_jt = . + 0x1b7c98;
		dp_connector_post_open.cfi_jt = . + 0x1b7ca0;
		dp_mst_connector_pre_destroy.cfi_jt = . + 0x1b7ca8;
		dsi_connector_put_modes.cfi_jt = . + 0x1b7cb0;
		dsi_conn_set_allowed_mode_switch.cfi_jt = . + 0x1b7cb8;
		dsi_conn_set_dyn_bit_clk.cfi_jt = . + 0x1b7cc0;
		dsi_display_set_backlight.cfi_jt = . + 0x1b7cc8;
		dsi_display_check_status.cfi_jt = . + 0x1b7cd0;
		dp_hdcp2p2_force_encryption.cfi_jt = . + 0x1b7cd8;
		dp_hdcp2p2_abort.cfi_jt = . + 0x1b7ce0;
		sde_hdcp_1x_force_encryption.cfi_jt = . + 0x1b7ce8;
		sde_hdcp_1x_abort.cfi_jt = . + 0x1b7cf0;
		sde_hdcp_2x_force_encryption.cfi_jt = . + 0x1b7cf8;
		dp_mst_display_hpd.cfi_jt = . + 0x1b7d00;
		sde_reg_dma_aspace_cb_locked.cfi_jt = . + 0x1b7d08;
		dsi_display_aspace_cb_locked.cfi_jt = . + 0x1b7d10;
		dsi_display_cmd_transfer.cfi_jt = . + 0x1b7d18;
		dsi_display_cmd_receive.cfi_jt = . + 0x1b7d20;
		dsi_display_get_dst_format.cfi_jt = . + 0x1b7d28;
		dsi_display_set_power.cfi_jt = . + 0x1b7d30;
		dp_hdcp2p2_register.cfi_jt = . + 0x1b7d38;
		dp_mst_display_set_mgr_state.cfi_jt = . + 0x1b7d40;
		dsi_pll_5nm_configure.cfi_jt = . + 0x1b7d48;
		dsi_pll_5nm_toggle.cfi_jt = . + 0x1b7d50;
		dsi_display_phy_pll_toggle.cfi_jt = . + 0x1b7d58;
		dsi_display_phy_configure.cfi_jt = . + 0x1b7d60;
		dsi_pre_clkoff_cb.cfi_jt = . + 0x1b7d68;
		dsi_post_clkon_cb.cfi_jt = . + 0x1b7d70;
		dsi_post_clkoff_cb.cfi_jt = . + 0x1b7d78;
		dsi_pre_clkon_cb.cfi_jt = . + 0x1b7d80;
		mi_display_powerkey_callback.cfi_jt = . + 0x1b7d88;
		dsi_display_firmware_display.cfi_jt = . + 0x1b7d90;
		dsi_display_clk_ctrl_cb.cfi_jt = . + 0x1b7d98;
		dsi_host_transfer.cfi_jt = . + 0x1b7da0;
		sde_rsc_get_io_resources.cfi_jt = . + 0x1b7da8;
		dsi_display_get_io_resources.cfi_jt = . + 0x1b7db0;
		dp_bridge_mode_fixup.cfi_jt = . + 0x1b7db8;
		dp_mst_bridge_mode_fixup.cfi_jt = . + 0x1b7dc0;
		dsi_bridge_mode_fixup.cfi_jt = . + 0x1b7dc8;
		dsi_display_drm_ext_bridge_mode_fixup.cfi_jt = . + 0x1b7dd0;
		dsi_display_drm_ext_bridge_mode_valid.cfi_jt = . + 0x1b7dd8;
		dp_bridge_mode_set.cfi_jt = . + 0x1b7de0;
		dp_mst_bridge_mode_set.cfi_jt = . + 0x1b7de8;
		dsi_bridge_mode_set.cfi_jt = . + 0x1b7df0;
		dsi_display_drm_ext_bridge_mode_set.cfi_jt = . + 0x1b7df8;
		dp_connector_detect.cfi_jt = . + 0x1b7e00;
		sde_wb_connector_detect.cfi_jt = . + 0x1b7e08;
		dsi_conn_detect.cfi_jt = . + 0x1b7e10;
		dsi_display_drm_ext_detect.cfi_jt = . + 0x1b7e18;
		dp_connector_get_modes.cfi_jt = . + 0x1b7e20;
		dp_mst_connector_get_modes.cfi_jt = . + 0x1b7e28;
		sde_wb_connector_get_modes.cfi_jt = . + 0x1b7e30;
		dsi_connector_get_modes.cfi_jt = . + 0x1b7e38;
		dsi_display_drm_ext_get_modes.cfi_jt = . + 0x1b7e40;
		dp_connector_mode_valid.cfi_jt = . + 0x1b7e48;
		dp_mst_connector_mode_valid.cfi_jt = . + 0x1b7e50;
		dsi_conn_mode_valid.cfi_jt = . + 0x1b7e58;
		dsi_display_drm_ext_mode_valid.cfi_jt = . + 0x1b7e60;
		dp_connector_atomic_check.cfi_jt = . + 0x1b7e68;
		dp_mst_connector_atomic_check.cfi_jt = . + 0x1b7e70;
		dsi_display_drm_ext_atomic_check.cfi_jt = . + 0x1b7e78;
		dp_connector_get_mode_info.cfi_jt = . + 0x1b7e80;
		dp_mst_connector_get_mode_info.cfi_jt = . + 0x1b7e88;
		sde_wb_get_mode_info.cfi_jt = . + 0x1b7e90;
		dsi_conn_get_mode_info.cfi_jt = . + 0x1b7e98;
		dsi_display_ext_get_mode_info.cfi_jt = . + 0x1b7ea0;
		dsi_host_attach.cfi_jt = . + 0x1b7ea8;
		dsi_host_detach.cfi_jt = . + 0x1b7eb0;
		dsi_host_ext_attach.cfi_jt = . + 0x1b7eb8;
		dp_connector_get_info.cfi_jt = . + 0x1b7ec0;
		sde_wb_get_info.cfi_jt = . + 0x1b7ec8;
		dsi_display_ext_get_info.cfi_jt = . + 0x1b7ed0;
		dsi_display_get_info.cfi_jt = . + 0x1b7ed8;
		dsi_display_get_panel_vfp.cfi_jt = . + 0x1b7ee0;
		dsi_display_get_default_lms.cfi_jt = . + 0x1b7ee8;
		__traceiter_rot_bw_ao_as_context.cfi_jt = . + 0x1b7ef0;
		__traceiter_sde_cmd_release_bw.cfi_jt = . + 0x1b7ef8;
		dsi_display_get_avr_step_req_fps.cfi_jt = . + 0x1b7f00;
		sde_connector_trigger_event.cfi_jt = . + 0x1b7f08;
		dsi_display_cb_error_handler.cfi_jt = . + 0x1b7f10;
		dsi_panel_pinctrl_init.cfi_jt = . + 0x1b7f18;
		dsi_panel_vm_stub.cfi_jt = . + 0x1b7f20;
		dsi_panel_gpio_request.cfi_jt = . + 0x1b7f28;
		dsi_panel_pinctrl_deinit.cfi_jt = . + 0x1b7f30;
		dsi_panel_gpio_release.cfi_jt = . + 0x1b7f38;
		dsi_panel_bl_register.cfi_jt = . + 0x1b7f40;
		dsi_panel_bl_unregister.cfi_jt = . + 0x1b7f48;
		dsi_panel_parse_gpios.cfi_jt = . + 0x1b7f50;
		dsi_panel_parse_power_cfg.cfi_jt = . + 0x1b7f58;
		dsi_panel_trigger_esd_attack.cfi_jt = . + 0x1b7f60;
		dsi_panel_vm_trigger_esd_attack.cfi_jt = . + 0x1b7f68;
		sde_rotator_ctx_show.cfi_jt = . + 0x1b7f70;
		lockdown_info_show.cfi_jt = . + 0x1b7f78;
		lcd_name_show.cfi_jt = . + 0x1b7f80;
		__traceiter_sde_encoder_underrun.cfi_jt = . + 0x1b7f88;
		dsi_display_clk_ctrl.cfi_jt = . + 0x1b7f90;
		sde_rot_evtlog_debug_work.cfi_jt = . + 0x1b7f98;
		dp_audio_notify_work_fn.cfi_jt = . + 0x1b7fa0;
		dp_bridge_hpd_work.cfi_jt = . + 0x1b7fa8;
		dp_mst_sim_down_req_work.cfi_jt = . + 0x1b7fb0;
		dp_mst_sim_reset_work.cfi_jt = . + 0x1b7fb8;
		dp_mst_sim_up_req_work.cfi_jt = . + 0x1b7fc0;
		dp_gpio_hpd_work.cfi_jt = . + 0x1b7fc8;
		dp_lphw_hpd_connect.cfi_jt = . + 0x1b7fd0;
		dp_lphw_hpd_disconnect.cfi_jt = . + 0x1b7fd8;
		dp_lphw_hpd_attention.cfi_jt = . + 0x1b7fe0;
		dp_display_hdcp_cb_work.cfi_jt = . + 0x1b7fe8;
		dp_display_connect_work.cfi_jt = . + 0x1b7ff0;
		dp_display_attention_work.cfi_jt = . + 0x1b7ff8;
		sde_hdcp_1x_auth_work.cfi_jt = . + 0x1b8000;
		sde_connector_check_status_work.cfi_jt = . + 0x1b8008;
		_sde_dump_work.cfi_jt = . + 0x1b8010;
		dsi_ctrl_post_cmd_transfer_work.cfi_jt = . + 0x1b8018;
		dsi_display_handle_fifo_underflow.cfi_jt = . + 0x1b8020;
		dsi_display_handle_fifo_overflow.cfi_jt = . + 0x1b8028;
		dsi_display_handle_lp_rx_timeout.cfi_jt = . + 0x1b8030;
		dsi_display_handle_poms_te.cfi_jt = . + 0x1b8038;
		dsi_display_test_work.cfi_jt = . + 0x1b8040;
		of_find_property.cfi_jt = . + 0x1b8048;
		dsi_parser_find_property.cfi_jt = . + 0x1b8050;
		of_property_read_bool.cfi_jt = . + 0x1b8058;
		of_property_read_bool.9804.cfi_jt = . + 0x1b8060;
		dsi_parser_read_bool.cfi_jt = . + 0x1b8068;
		of_property_read_string.cfi_jt = . + 0x1b8070;
		dsi_parser_read_string.cfi_jt = . + 0x1b8078;
		of_property_read_u64.cfi_jt = . + 0x1b8080;
		dsi_parser_read_u64.cfi_jt = . + 0x1b8088;
		of_property_read_u32.cfi_jt = . + 0x1b8090;
		of_property_read_u32.9803.cfi_jt = . + 0x1b8098;
		dsi_parser_read_u32.cfi_jt = . + 0x1b80a0;
		of_property_read_u32_index.cfi_jt = . + 0x1b80a8;
		dsi_parser_read_u32_index.cfi_jt = . + 0x1b80b0;
		of_property_read_u32_array.cfi_jt = . + 0x1b80b8;
		of_property_read_u32_array.9805.cfi_jt = . + 0x1b80c0;
		dsi_parser_read_u32_array.cfi_jt = . + 0x1b80c8;
		of_get_property.cfi_jt = . + 0x1b80d0;
		dsi_parser_get_property.cfi_jt = . + 0x1b80d8;
		of_get_child_by_name.cfi_jt = . + 0x1b80e0;
		dsi_parser_get_child_by_name.cfi_jt = . + 0x1b80e8;
		of_get_child_count.cfi_jt = . + 0x1b80f0;
		of_get_available_child_count.cfi_jt = . + 0x1b80f8;
		of_get_child_count.9807.cfi_jt = . + 0x1b8100;
		of_get_available_child_count.9811.cfi_jt = . + 0x1b8108;
		dsi_parser_get_child_count.cfi_jt = . + 0x1b8110;
		of_get_next_child.cfi_jt = . + 0x1b8118;
		dsi_parser_get_next_child.cfi_jt = . + 0x1b8120;
		of_property_count_u32_elems.cfi_jt = . + 0x1b8128;
		of_property_count_strings.cfi_jt = . + 0x1b8130;
		of_property_count_u32_elems.9808.cfi_jt = . + 0x1b8138;
		of_property_count_strings.9809.cfi_jt = . + 0x1b8140;
		dsi_parser_count_u32_elems.cfi_jt = . + 0x1b8148;
		dsi_parser_count_strings.cfi_jt = . + 0x1b8150;
		of_property_read_string_index.cfi_jt = . + 0x1b8158;
		of_property_read_string_index.9806.cfi_jt = . + 0x1b8160;
		dsi_parser_read_string_index.cfi_jt = . + 0x1b8168;
		of_get_named_gpio.cfi_jt = . + 0x1b8170;
		of_get_named_gpio.9810.cfi_jt = . + 0x1b8178;
		dsi_parser_get_named_gpio.cfi_jt = . + 0x1b8180;
		msm_atomic_commit.cfi_jt = . + 0x1b8188;
		autoremove_wake_function.cfi_jt = . + 0x1b8190;
		msm_atomic_state_alloc.cfi_jt = . + 0x1b8198;
		msm_atomic_state_clear.cfi_jt = . + 0x1b81a0;
		msm_atomic_state_free.cfi_jt = . + 0x1b81a8;
		msm_atomic_commit_tail.cfi_jt = . + 0x1b81b0;
		msm_framebuffer_create.cfi_jt = . + 0x1b81b8;
		drm_gem_fb_destroy.cfi_jt = . + 0x1b81c0;
		drm_gem_fb_create_handle.cfi_jt = . + 0x1b81c8;
		drm_atomic_helper_dirtyfb.cfi_jt = . + 0x1b81d0;
		msm_atomic_check.cfi_jt = . + 0x1b81d8;
		init_module.cfi_jt = . + 0x1b81e0;
		sde_rotator_inline_reg_dump.cfi_jt = . + 0x1b81e8;
		dp_audio_teardown_done.cfi_jt = . + 0x1b81f0;
		dsi_display_dev_shutdown.cfi_jt = . + 0x1b81f8;
		msm_pdev_shutdown.cfi_jt = . + 0x1b8200;
		sde_rotator_runtime_suspend.cfi_jt = . + 0x1b8208;
		sde_rotator_runtime_resume.cfi_jt = . + 0x1b8210;
		sde_rotator_runtime_idle.cfi_jt = . + 0x1b8218;
		sde_rotator_pm_suspend.cfi_jt = . + 0x1b8220;
		sde_rotator_pm_resume.cfi_jt = . + 0x1b8228;
		dp_pm_prepare.cfi_jt = . + 0x1b8230;
		dp_display_usbpd_configure_cb.cfi_jt = . + 0x1b8238;
		dp_display_usbpd_disconnect_cb.cfi_jt = . + 0x1b8240;
		dp_display_usbpd_attention_cb.cfi_jt = . + 0x1b8248;
		sde_kms_pm_suspend.cfi_jt = . + 0x1b8250;
		sde_kms_pm_resume.cfi_jt = . + 0x1b8258;
		msm_pm_suspend.cfi_jt = . + 0x1b8260;
		msm_pm_resume.cfi_jt = . + 0x1b8268;
		msm_runtime_suspend.cfi_jt = . + 0x1b8270;
		msm_runtime_resume.cfi_jt = . + 0x1b8278;
		msm_drm_bind.cfi_jt = . + 0x1b8280;
		msm_hdcp_notify_topology.cfi_jt = . + 0x1b8288;
		dp_pm_complete.cfi_jt = . + 0x1b8290;
		msm_drm_unbind.cfi_jt = . + 0x1b8298;
		compare_of.cfi_jt = . + 0x1b82a0;
		compare_name_mdp.cfi_jt = . + 0x1b82a8;
		msm_open.cfi_jt = . + 0x1b82b0;
		msm_postclose.cfi_jt = . + 0x1b82b8;
		msm_irq_postinstall.cfi_jt = . + 0x1b82c0;
		msm_lastclose.cfi_jt = . + 0x1b82c8;
		msm_fb_output_poll_changed.cfi_jt = . + 0x1b82d0;
		msm_irq_preinstall.cfi_jt = . + 0x1b82d8;
		msm_irq_uninstall.cfi_jt = . + 0x1b82e0;
		drm_gem_prime_handle_to_fd.cfi_jt = . + 0x1b82e8;
		drm_gem_prime_fd_to_handle.cfi_jt = . + 0x1b82f0;
		drm_gem_prime_export.cfi_jt = . + 0x1b82f8;
		seq_lseek.cfi_jt = . + 0x1b8300;
		no_llseek.cfi_jt = . + 0x1b8308;
		sde_wb_config.cfi_jt = . + 0x1b8310;
		msm_ioctl_rmfb2.cfi_jt = . + 0x1b8318;
		msm_ioctl_power_ctrl.cfi_jt = . + 0x1b8320;
		msm_ioctl_display_hint_ops.cfi_jt = . + 0x1b8328;
		msm_ioctl_gem_new.cfi_jt = . + 0x1b8330;
		msm_ioctl_gem_cpu_prep.cfi_jt = . + 0x1b8338;
		msm_ioctl_gem_cpu_fini.cfi_jt = . + 0x1b8340;
		msm_ioctl_gem_madvise.cfi_jt = . + 0x1b8348;
		msm_ioctl_register_event.cfi_jt = . + 0x1b8350;
		msm_ioctl_deregister_event.cfi_jt = . + 0x1b8358;
		drm_gem_vm_open.cfi_jt = . + 0x1b8360;
		drm_gem_vm_close.cfi_jt = . + 0x1b8368;
		default_dump_reg.cfi_jt = . + 0x1b8370;
		dump_regs_v1.cfi_jt = . + 0x1b8378;
		cleanup_module.cfi_jt = . + 0x1b8380;
		msm_gem_mmap.cfi_jt = . + 0x1b8388;
		msm_gem_fault.cfi_jt = . + 0x1b8390;
		msm_gem_dumb_create.cfi_jt = . + 0x1b8398;
		msm_gem_dumb_map_offset.cfi_jt = . + 0x1b83a0;
		msm_gem_prime_get_sg_table.cfi_jt = . + 0x1b83a8;
		msm_gem_prime_vmap.cfi_jt = . + 0x1b83b0;
		msm_gem_prime_vunmap.cfi_jt = . + 0x1b83b8;
		msm_gem_prime_mmap.cfi_jt = . + 0x1b83c0;
		msm_gem_prime_import_sg_table.cfi_jt = . + 0x1b83c8;
		msm_gem_prime_pin.cfi_jt = . + 0x1b83d0;
		msm_gem_free_object.cfi_jt = . + 0x1b83d8;
		msm_gem_prime_unpin.cfi_jt = . + 0x1b83e0;
		msm_gem_prime_import.cfi_jt = . + 0x1b83e8;
		smmu_aspace_add_to_active.cfi_jt = . + 0x1b83f0;
		smmu_aspace_remove_from_active.cfi_jt = . + 0x1b83f8;
		smmu_aspace_register_cb.cfi_jt = . + 0x1b8400;
		smmu_aspace_unregister_cb.cfi_jt = . + 0x1b8408;
		sde_rotator_free_timeline.cfi_jt = . + 0x1b8410;
		dma_fence_release.cfi_jt = . + 0x1b8418;
		__drm_atomic_state_free.cfi_jt = . + 0x1b8420;
		sde_kms_irq_affinity_release.cfi_jt = . + 0x1b8428;
		sde_fence_destroy.cfi_jt = . + 0x1b8430;
		drm_gem_object_free.cfi_jt = . + 0x1b8438;
		msm_gem_address_space_destroy.cfi_jt = . + 0x1b8440;
		smmu_aspace_map_vma.cfi_jt = . + 0x1b8448;
		iommu_aspace_map_vma.cfi_jt = . + 0x1b8450;
		smmu_aspace_unmap_vma.cfi_jt = . + 0x1b8458;
		iommu_aspace_unmap_vma.cfi_jt = . + 0x1b8460;
		smmu_aspace_destroy.cfi_jt = . + 0x1b8468;
		iommu_aspace_destroy.cfi_jt = . + 0x1b8470;
		msm_smmu_get_dev.cfi_jt = . + 0x1b8478;
		msm_iommu_attach.cfi_jt = . + 0x1b8480;
		msm_smmu_attach.cfi_jt = . + 0x1b8488;
		msm_iommu_detach.cfi_jt = . + 0x1b8490;
		msm_smmu_detach.cfi_jt = . + 0x1b8498;
		msm_iommu_map.cfi_jt = . + 0x1b84a0;
		msm_smmu_map.cfi_jt = . + 0x1b84a8;
		msm_iommu_unmap.cfi_jt = . + 0x1b84b0;
		msm_smmu_unmap.cfi_jt = . + 0x1b84b8;
		msm_smmu_map_dma_buf.cfi_jt = . + 0x1b84c0;
		msm_smmu_unmap_dma_buf.cfi_jt = . + 0x1b84c8;
		msm_iommu_destroy.cfi_jt = . + 0x1b84d0;
		msm_smmu_destroy.cfi_jt = . + 0x1b84d8;
		msm_smmu_is_domain_secure.cfi_jt = . + 0x1b84e0;
		msm_smmu_set_attribute.cfi_jt = . + 0x1b84e8;
		msm_smmu_one_to_one_map.cfi_jt = . + 0x1b84f0;
		msm_smmu_one_to_one_unmap.cfi_jt = . + 0x1b84f8;
		msm_hdcp_probe.cfi_jt = . + 0x1b8500;
		msm_hdcp_remove.cfi_jt = . + 0x1b8508;
		sde_rotator_inline_get_maxlinewidth.cfi_jt = . + 0x1b8510;
		sde_rotator_probe.cfi_jt = . + 0x1b8518;
		sde_rotator_remove.cfi_jt = . + 0x1b8520;
		sde_smmu_probe.cfi_jt = . + 0x1b8528;
		sde_smmu_remove.cfi_jt = . + 0x1b8530;
		dp_audio_get_intf_id.cfi_jt = . + 0x1b8538;
		dp_audio_codec_ready.cfi_jt = . + 0x1b8540;
		dp_display_probe.cfi_jt = . + 0x1b8548;
		dp_display_remove.cfi_jt = . + 0x1b8550;
		sde_wb_probe.cfi_jt = . + 0x1b8558;
		sde_wb_remove.cfi_jt = . + 0x1b8560;
		sde_rsc_rpmh_remove.cfi_jt = . + 0x1b8568;
		sde_rsc_probe.cfi_jt = . + 0x1b8570;
		sde_rsc_remove.cfi_jt = . + 0x1b8578;
		sde_rsc_rpmh_probe.cfi_jt = . + 0x1b8580;
		dsi_phy_driver_probe.cfi_jt = . + 0x1b8588;
		dsi_phy_driver_remove.cfi_jt = . + 0x1b8590;
		dsi_ctrl_dev_probe.cfi_jt = . + 0x1b8598;
		dsi_ctrl_dev_remove.cfi_jt = . + 0x1b85a0;
		dsi_display_dev_probe.cfi_jt = . + 0x1b85a8;
		dsi_display_dev_remove.cfi_jt = . + 0x1b85b0;
		msm_pdev_probe.cfi_jt = . + 0x1b85b8;
		msm_pdev_remove.cfi_jt = . + 0x1b85c0;
		msm_smmu_probe.cfi_jt = . + 0x1b85c8;
		msm_smmu_remove.cfi_jt = . + 0x1b85d0;
		sde_smmu_fault_handler.cfi_jt = . + 0x1b85d8;
		msm_fault_handler.cfi_jt = . + 0x1b85e0;
		msm_smmu_fault_handler.cfi_jt = . + 0x1b85e8;
		dp_display_bind.cfi_jt = . + 0x1b85f0;
		sde_wb_bind.cfi_jt = . + 0x1b85f8;
		sde_rsc_bind.cfi_jt = . + 0x1b8600;
		dsi_display_bind.cfi_jt = . + 0x1b8608;
		msm_smmu_bind.cfi_jt = . + 0x1b8610;
		dp_display_unbind.cfi_jt = . + 0x1b8618;
		sde_wb_unbind.cfi_jt = . + 0x1b8620;
		sde_rsc_unbind.cfi_jt = . + 0x1b8628;
		dsi_display_unbind.cfi_jt = . + 0x1b8630;
		msm_smmu_unbind.cfi_jt = . + 0x1b8638;
		mi_disp_devnode.cfi_jt = . + 0x1b8640;
		sde_rotator_poll.cfi_jt = . + 0x1b8648;
		drm_poll.cfi_jt = . + 0x1b8650;
		mi_disp_poll.cfi_jt = . + 0x1b8658;
		mi_disp_ioctl_get_version.cfi_jt = . + 0x1b8660;
		mi_disp_ioctl_set_feature.cfi_jt = . + 0x1b8668;
		mi_disp_ioctl_set_doze_brightness.cfi_jt = . + 0x1b8670;
		mi_disp_ioctl_get_doze_brightness.cfi_jt = . + 0x1b8678;
		mi_disp_ioctl_get_panel_info.cfi_jt = . + 0x1b8680;
		mi_disp_ioctl_get_wp_info.cfi_jt = . + 0x1b8688;
		mi_disp_ioctl_get_fps.cfi_jt = . + 0x1b8690;
		mi_disp_ioctl_register_event.cfi_jt = . + 0x1b8698;
		mi_disp_ioctl_deregister_event.cfi_jt = . + 0x1b86a0;
		mi_disp_ioctl_write_dsi_cmd.cfi_jt = . + 0x1b86a8;
		mi_disp_ioctl_read_dsi_cmd.cfi_jt = . + 0x1b86b0;
		mi_disp_ioctl_get_brightness.cfi_jt = . + 0x1b86b8;
		mi_disp_ioctl_get_feature.cfi_jt = . + 0x1b86c0;
		mi_disp_ioctl_get_manufacturer_info.cfi_jt = . + 0x1b86c8;
		mi_disp_ioctl_set_local_hbm.cfi_jt = . + 0x1b86d0;
		video_ioctl2.cfi_jt = . + 0x1b86d8;
		sde_rotator_compat_ioctl32.cfi_jt = . + 0x1b86e0;
		drm_ioctl.cfi_jt = . + 0x1b86e8;
		drm_compat_ioctl.cfi_jt = . + 0x1b86f0;
		mi_disp_ioctl.cfi_jt = . + 0x1b86f8;
		mi_disp_ioctl_compat.cfi_jt = . + 0x1b8700;
		sde_rotator_raw_show.cfi_jt = . + 0x1b8708;
		sde_rotator_stat_show.cfi_jt = . + 0x1b8710;
		_sde_debugfs_fence_status_show.cfi_jt = . + 0x1b8718;
		_sde_debugfs_fps_status_show.cfi_jt = . + 0x1b8720;
		sde_crtc_debugfs_state_show.cfi_jt = . + 0x1b8728;
		_sde_debugfs_status_show.cfi_jt = . + 0x1b8730;
		_sde_encoder_status_show.cfi_jt = . + 0x1b8738;
		sde_debugfs_core_irq_show.cfi_jt = . + 0x1b8740;
		_sde_rm_status_show.cfi_jt = . + 0x1b8748;
		_sde_debugfs_counters_show.cfi_jt = . + 0x1b8750;
		_sde_debugfs_status_show.8173.cfi_jt = . + 0x1b8758;
		mi_disp_procfs_tx_cmd_set_show.cfi_jt = . + 0x1b8760;
		mi_disp_procfs_mipi_rw_show.cfi_jt = . + 0x1b8768;
		mi_disp_debugfs_fod_test_show.cfi_jt = . + 0x1b8770;
		mi_disp_debugfs_esd_sw_show.cfi_jt = . + 0x1b8778;
		disp_log_printk_utc.cfi_jt = . + 0x1b8780;
		disp_log_printk.cfi_jt = . + 0x1b8788;
		msm_hdcp_open.cfi_jt = . + 0x1b8790;
		msm_hdcp_close.cfi_jt = . + 0x1b8798;
		sde_rot_evtlog_dump_open.cfi_jt = . + 0x1b87a0;
		sde_rotator_raw_open.cfi_jt = . + 0x1b87a8;
		single_release.cfi_jt = . + 0x1b87b0;
		sde_rotator_stat_open.cfi_jt = . + 0x1b87b8;
		simple_open.cfi_jt = . + 0x1b87c0;
		_sde_debugfs_fence_status.cfi_jt = . + 0x1b87c8;
		_sde_debugfs_fps_status.cfi_jt = . + 0x1b87d0;
		sde_crtc_debugfs_state_open.cfi_jt = . + 0x1b87d8;
		_sde_debugfs_status_open.cfi_jt = . + 0x1b87e0;
		_sde_encoder_debugfs_status_open.cfi_jt = . + 0x1b87e8;
		sde_debugfs_core_irq_open.cfi_jt = . + 0x1b87f0;
		_sde_rm_debugfs_status_open.cfi_jt = . + 0x1b87f8;
		_sde_debugfs_conn_cmd_rx_open.cfi_jt = . + 0x1b8800;
		_sde_debugfs_conn_cmd_tx_open.cfi_jt = . + 0x1b8808;
		sde_dbg_reg_base_open.cfi_jt = . + 0x1b8810;
		sde_dbg_reg_base_release.cfi_jt = . + 0x1b8818;
		sde_recovery_dp_dbgbus_dump_open.cfi_jt = . + 0x1b8820;
		sde_recovery_lutdma_dbgbus_dump_open.cfi_jt = . + 0x1b8828;
		sde_recovery_rsc_dbgbus_dump_open.cfi_jt = . + 0x1b8830;
		sde_recovery_dsi_dbgbus_dump_open.cfi_jt = . + 0x1b8838;
		sde_recovery_vbif_dbgbus_dump_open.cfi_jt = . + 0x1b8840;
		sde_recovery_dbgbus_dump_open.cfi_jt = . + 0x1b8848;
		sde_recovery_regdump_open.cfi_jt = . + 0x1b8850;
		sde_dbg_debugfs_open.cfi_jt = . + 0x1b8858;
		_sde_debugfs_counters_open.cfi_jt = . + 0x1b8860;
		_sde_debugfs_generic_noseek_open.cfi_jt = . + 0x1b8868;
		_sde_debugfs_status_open.8172.cfi_jt = . + 0x1b8870;
		drm_open.cfi_jt = . + 0x1b8878;
		msm_release.cfi_jt = . + 0x1b8880;
		mi_disp_open.cfi_jt = . + 0x1b8888;
		mi_disp_release.cfi_jt = . + 0x1b8890;
		mi_disp_procfs_tx_cmd_set_open.cfi_jt = . + 0x1b8898;
		mi_disp_procfs_mipi_rw_open.cfi_jt = . + 0x1b88a0;
		mi_disp_debugfs_fod_test_open.cfi_jt = . + 0x1b88a8;
		mi_disp_debugfs_esd_sw_open.cfi_jt = . + 0x1b88b0;
		mi_disp_log_debugfs_open.cfi_jt = . + 0x1b88b8;
		mi_disp_log_open.cfi_jt = . + 0x1b88c0;
		mi_disp_log_debugfs_release.cfi_jt = . + 0x1b88c8;
		min_level_change_store.cfi_jt = . + 0x1b88d0;
		tp_store.cfi_jt = . + 0x1b88d8;
		fps_periodicity_ms_store.cfi_jt = . + 0x1b88e0;
		brightness_clone_store.cfi_jt = . + 0x1b88e8;
		doze_brightness_store.cfi_jt = . + 0x1b88f0;
		mipi_rw_store.cfi_jt = . + 0x1b88f8;
		disp_param_store.cfi_jt = . + 0x1b8900;
		user_buf_store.cfi_jt = . + 0x1b8908;
		tp_show.cfi_jt = . + 0x1b8910;
		state_show.cfi_jt = . + 0x1b8918;
		caps_show.cfi_jt = . + 0x1b8920;
		retire_frame_event_show.cfi_jt = . + 0x1b8928;
		fps_periodicity_ms_show.cfi_jt = . + 0x1b8930;
		measured_fps_show.cfi_jt = . + 0x1b8938;
		vsync_event_show.cfi_jt = . + 0x1b8940;
		panel_manufacturer_info_show.cfi_jt = . + 0x1b8948;
		flatmode_check_show.cfi_jt = . + 0x1b8950;
		cell_id_show.cfi_jt = . + 0x1b8958;
		hw_vsync_info_show.cfi_jt = . + 0x1b8960;
		max_brightness_clone_show.cfi_jt = . + 0x1b8968;
		brightness_clone_show.cfi_jt = . + 0x1b8970;
		doze_brightness_show.cfi_jt = . + 0x1b8978;
		dynamic_fps_show.cfi_jt = . + 0x1b8980;
		wp_info_show.cfi_jt = . + 0x1b8988;
		panel_build_id_show.cfi_jt = . + 0x1b8990;
		panel_info_show.cfi_jt = . + 0x1b8998;
		mipi_rw_show.cfi_jt = . + 0x1b89a0;
		disp_param_show.cfi_jt = . + 0x1b89a8;
		kernel_buf_show.cfi_jt = . + 0x1b89b0;
		user_buf_show.cfi_jt = . + 0x1b89b8;
		info_show.cfi_jt = . + 0x1b89c0;
		sde_rot_evtlog_dump_read.cfi_jt = . + 0x1b89c8;
		seq_read.cfi_jt = . + 0x1b89d0;
		dp_debug_read_dump.cfi_jt = . + 0x1b89d8;
		dp_debug_tpg_read.cfi_jt = . + 0x1b89e0;
		dp_debug_max_pclk_khz_read.cfi_jt = . + 0x1b89e8;
		dp_debug_bw_code_read.cfi_jt = . + 0x1b89f0;
		dp_debug_mst_mode_read.cfi_jt = . + 0x1b89f8;
		dp_debug_read_mst_conn_info.cfi_jt = . + 0x1b8a00;
		dp_debug_read_mst_con_id.cfi_jt = . + 0x1b8a08;
		dp_debug_read_dpcd.cfi_jt = . + 0x1b8a10;
		dp_debug_read_edid_modes_mst.cfi_jt = . + 0x1b8a18;
		dp_debug_read_edid_modes.cfi_jt = . + 0x1b8a20;
		dp_debug_read_hdcp.cfi_jt = . + 0x1b8a28;
		dp_debug_read_hdr_mst.cfi_jt = . + 0x1b8a30;
		dp_debug_read_hdr.cfi_jt = . + 0x1b8a38;
		dp_debug_read_connected.cfi_jt = . + 0x1b8a40;
		dp_debug_read_info.cfi_jt = . + 0x1b8a48;
		dp_sim_debug_read_dpcd.cfi_jt = . + 0x1b8a50;
		_sde_crtc_misr_read.cfi_jt = . + 0x1b8a58;
		_sde_encoder_misr_read.cfi_jt = . + 0x1b8a60;
		_sde_core_perf_mmrm_read.cfi_jt = . + 0x1b8a68;
		_sde_core_perf_mode_read.cfi_jt = . + 0x1b8a70;
		_sde_core_perf_threshold_high_read.cfi_jt = . + 0x1b8a78;
		_sde_plane_danger_read.cfi_jt = . + 0x1b8a80;
		_sde_debugfs_conn_cmd_rx_read.cfi_jt = . + 0x1b8a88;
		_sde_debugfs_conn_cmd_tx_sts_read.cfi_jt = . + 0x1b8a90;
		sde_dbg_reg_base_reg_read.cfi_jt = . + 0x1b8a98;
		sde_dbg_reg_base_offset_read.cfi_jt = . + 0x1b8aa0;
		sde_recovery_dbgbus_dump_read.cfi_jt = . + 0x1b8aa8;
		sde_recovery_regdump_read.cfi_jt = . + 0x1b8ab0;
		sde_evtlog_dump_read.cfi_jt = . + 0x1b8ab8;
		sde_dbg_ctrl_read.cfi_jt = . + 0x1b8ac0;
		_sde_debugfs_profiling_read.cfi_jt = . + 0x1b8ac8;
		_sde_debugfs_vsync_mode_read.cfi_jt = . + 0x1b8ad0;
		_sde_debugfs_mode_ctrl_read.cfi_jt = . + 0x1b8ad8;
		debugfs_line_count_read.cfi_jt = . + 0x1b8ae0;
		debugfs_reg_dump_read.cfi_jt = . + 0x1b8ae8;
		debugfs_state_info_read.cfi_jt = . + 0x1b8af0;
		debugfs_misr_read.cfi_jt = . + 0x1b8af8;
		debugfs_read_cmd_scheduling_params.cfi_jt = . + 0x1b8b00;
		debugfs_read_esd_check_mode.cfi_jt = . + 0x1b8b08;
		debugfs_dump_info_read.cfi_jt = . + 0x1b8b10;
		dsi_parser_read_node.cfi_jt = . + 0x1b8b18;
		drm_read.cfi_jt = . + 0x1b8b20;
		mi_disp_read.cfi_jt = . + 0x1b8b28;
		mi_disp_log_debugfs_read.cfi_jt = . + 0x1b8b30;
		mi_disp_log_read.cfi_jt = . + 0x1b8b38;
		dp_debug_write_dump.cfi_jt = . + 0x1b8b40;
		dp_debug_write_exe_mode.cfi_jt = . + 0x1b8b48;
		dp_debug_tpg_write.cfi_jt = . + 0x1b8b50;
		dp_debug_write_attention.cfi_jt = . + 0x1b8b58;
		dp_debug_write_sim.cfi_jt = . + 0x1b8b60;
		dp_debug_write_hpd.cfi_jt = . + 0x1b8b68;
		dp_debug_mmrm_clk_cb_write.cfi_jt = . + 0x1b8b70;
		dp_debug_max_pclk_khz_write.cfi_jt = . + 0x1b8b78;
		dp_debug_bw_code_write.cfi_jt = . + 0x1b8b80;
		dp_debug_mst_sideband_mode_write.cfi_jt = . + 0x1b8b88;
		dp_debug_mst_mode_write.cfi_jt = . + 0x1b8b90;
		dp_debug_write_mst_con_remove.cfi_jt = . + 0x1b8b98;
		dp_debug_write_mst_con_add.cfi_jt = . + 0x1b8ba0;
		dp_debug_write_mst_con_id.cfi_jt = . + 0x1b8ba8;
		dp_debug_write_dpcd.cfi_jt = . + 0x1b8bb0;
		dp_debug_write_edid.cfi_jt = . + 0x1b8bb8;
		dp_debug_write_edid_modes_mst.cfi_jt = . + 0x1b8bc0;
		dp_debug_write_edid_modes.cfi_jt = . + 0x1b8bc8;
		dp_debug_write_hdcp.cfi_jt = . + 0x1b8bd0;
		dp_sim_debug_write_mst_mode.cfi_jt = . + 0x1b8bd8;
		dp_sim_debug_write_skip_config.cfi_jt = . + 0x1b8be0;
		dp_sim_debug_write_skip_dpcd.cfi_jt = . + 0x1b8be8;
		dp_sim_debug_write_skip_edid.cfi_jt = . + 0x1b8bf0;
		dp_sim_debug_write_skip_link_training.cfi_jt = . + 0x1b8bf8;
		dp_sim_debug_write_hpd.cfi_jt = . + 0x1b8c00;
		dp_sim_debug_write_dpcd.cfi_jt = . + 0x1b8c08;
		dp_sim_debug_write_mst_hpd.cfi_jt = . + 0x1b8c10;
		dp_sim_debug_write_edid.cfi_jt = . + 0x1b8c18;
		_sde_crtc_misr_setup.cfi_jt = . + 0x1b8c20;
		_sde_encoder_misr_setup.cfi_jt = . + 0x1b8c28;
		_sde_core_perf_mmrm_write.cfi_jt = . + 0x1b8c30;
		_sde_core_perf_mode_write.cfi_jt = . + 0x1b8c38;
		_sde_core_perf_threshold_high_write.cfi_jt = . + 0x1b8c40;
		_sde_plane_danger_write.cfi_jt = . + 0x1b8c48;
		_sde_debugfs_conn_cmd_rx_write.cfi_jt = . + 0x1b8c50;
		_sde_debugfs_conn_cmd_tx_write.cfi_jt = . + 0x1b8c58;
		sde_dbg_reg_base_offset_write.cfi_jt = . + 0x1b8c60;
		sde_evtlog_dump_write.cfi_jt = . + 0x1b8c68;
		sde_dbg_ctrl_write.cfi_jt = . + 0x1b8c70;
		_sde_debugfs_profiling_write.cfi_jt = . + 0x1b8c78;
		_sde_debugfs_vsync_mode_write.cfi_jt = . + 0x1b8c80;
		_sde_debugfs_mode_ctrl_write.cfi_jt = . + 0x1b8c88;
		debugfs_misr_setup.cfi_jt = . + 0x1b8c90;
		debugfs_update_cmd_scheduling_params.cfi_jt = . + 0x1b8c98;
		debugfs_alter_esd_check_mode.cfi_jt = . + 0x1b8ca0;
		debugfs_esd_trigger_check.cfi_jt = . + 0x1b8ca8;
		dsi_parser_write_node.cfi_jt = . + 0x1b8cb0;
		dsi_parser_write_init.cfi_jt = . + 0x1b8cb8;
		mi_disp_procfs_tx_cmd_set_write.cfi_jt = . + 0x1b8cc0;
		mi_disp_procfs_mipi_rw_write.cfi_jt = . + 0x1b8cc8;
		mi_disp_debugfs_fod_test_write.cfi_jt = . + 0x1b8cd0;
		mi_disp_debugfs_esd_sw_write.cfi_jt = . + 0x1b8cd8;
		mi_disp_log_debugfs_write.cfi_jt = . + 0x1b8ce0;
		mi_disp_log_write.cfi_jt = . + 0x1b8ce8;
		sde_rotator_inline_release.cfi_jt = . + 0x1b8cf0;
		kthread_worker_fn.cfi_jt = . + 0x1b8cf8;
		sde_rotator_job_ready.cfi_jt = . + 0x1b8d00;
		_sde_vm_msgq_listener.cfi_jt = . + 0x1b8d08;
		dp_display_pre_hw_release.cfi_jt = . + 0x1b8d10;
		dp_display_post_hw_acquire.cfi_jt = . + 0x1b8d18;
		dp_hdcp2p2_main.cfi_jt = . + 0x1b8d20;
		dp_hdcp2p2_isr.cfi_jt = . + 0x1b8d28;
		dp_hdcp2p2_cp_irq.cfi_jt = . + 0x1b8d30;
		dp_hdcp2p2_reauthenticate.cfi_jt = . + 0x1b8d38;
		dp_hdcp2p2_authenticate.cfi_jt = . + 0x1b8d40;
		dp_hdcp2p2_on.cfi_jt = . + 0x1b8d48;
		sde_hdcp_1x_isr.cfi_jt = . + 0x1b8d50;
		sde_hdcp_1x_cp_irq.cfi_jt = . + 0x1b8d58;
		sde_hdcp_1x_reauthenticate.cfi_jt = . + 0x1b8d60;
		sde_hdcp_1x_authenticate.cfi_jt = . + 0x1b8d68;
		sde_hdcp_2x_main.cfi_jt = . + 0x1b8d70;
		dsi_display_soft_reset.cfi_jt = . + 0x1b8d78;
		dsi_display_cont_splash_res_disable.cfi_jt = . + 0x1b8d80;
		dsi_display_cont_splash_config.cfi_jt = . + 0x1b8d88;
		dsi_display_pre_release.cfi_jt = . + 0x1b8d90;
		dsi_display_pre_acquire.cfi_jt = . + 0x1b8d98;
		mi_disp_lhbm_fod_thread_fn.cfi_jt = . + 0x1b8da0;
		sde_rotator_submit_handler.cfi_jt = . + 0x1b8da8;
		sde_rotator_retire_handler.cfi_jt = . + 0x1b8db0;
		sde_rotator_commit_handler.cfi_jt = . + 0x1b8db8;
		sde_rotator_done_handler.cfi_jt = . + 0x1b8dc0;
		rotator_thread_priority_worker.cfi_jt = . + 0x1b8dc8;
		_sde_vm_msgq_process_msg.cfi_jt = . + 0x1b8dd0;
		_sde_crtc_event_cb.cfi_jt = . + 0x1b8dd8;
		__sde_crtc_static_cache_read_work.cfi_jt = . + 0x1b8de0;
		sde_crtc_frame_event_work.cfi_jt = . + 0x1b8de8;
		vblank_ctrl_worker.cfi_jt = . + 0x1b8df0;
		sde_encoder_off_work.cfi_jt = . + 0x1b8df8;
		sde_encoder_input_event_work_handler.cfi_jt = . + 0x1b8e00;
		sde_encoder_early_wakeup_work_handler.cfi_jt = . + 0x1b8e08;
		sde_encoder_esd_trigger_work_handler.cfi_jt = . + 0x1b8e10;
		_msm_drm_commit_work_cb.cfi_jt = . + 0x1b8e18;
		msm_drm_display_thread_priority_worker.cfi_jt = . + 0x1b8e20;
		mi_disp_set_doze_brightness_work_handler.cfi_jt = . + 0x1b8e28;
		mi_disp_set_feature_work_handler.cfi_jt = . + 0x1b8e30;
		mi_disp_set_dimming_delayed_work_handler.cfi_jt = . + 0x1b8e38;
		mi_disp_timming_switch_delayed_work_handler.cfi_jt = . + 0x1b8e40;
		sde_irq_handler.cfi_jt = . + 0x1b8e48;
		sde_hw_rotator_rotirq_handler.cfi_jt = . + 0x1b8e50;
		sde_hw_rotator_regdmairq_handler.cfi_jt = . + 0x1b8e58;
		dp_gpio_isr.cfi_jt = . + 0x1b8e60;
		dp_tlmm_isr.cfi_jt = . + 0x1b8e68;
		dp_display_irq.cfi_jt = . + 0x1b8e70;
		dsi_ctrl_isr.cfi_jt = . + 0x1b8e78;
		dsi_display_panel_te_irq_handler.cfi_jt = . + 0x1b8e80;
		msm_irq.cfi_jt = . + 0x1b8e88;
		mi_esd_err_irq_handle.cfi_jt = . + 0x1b8e90;
		sde_cdev_get_max_brightness.cfi_jt = . + 0x1b8e98;
		sde_cdev_get_cur_brightness.cfi_jt = . + 0x1b8ea0;
		mi_sde_cdev_get_max_brightness.cfi_jt = . + 0x1b8ea8;
		mi_sde_cdev_get_cur_brightness.cfi_jt = . + 0x1b8eb0;
		sde_cdev_set_cur_brightness.cfi_jt = . + 0x1b8eb8;
		mi_sde_cdev_set_cur_brightness.cfi_jt = . + 0x1b8ec0;
		dp_display_usb_notifier.cfi_jt = . + 0x1b8ec8;
		dp_display_fsa4480_callback.cfi_jt = . + 0x1b8ed0;
		sde_backlight_cooling_cb.cfi_jt = . + 0x1b8ed8;
		mi_sde_backlight_cooling_cb.cfi_jt = . + 0x1b8ee0;
		ocp2131_bias_probe.cfi_jt = . + 0x1b8ee8;
		sy7758_probe.cfi_jt = . + 0x1b8ef0;
		ocp2131_bias_remove.cfi_jt = . + 0x1b8ef8;
		sy7758_remove.cfi_jt = . + 0x1b8f00;
		sy_update_status.cfi_jt = . + 0x1b8f08;
		sy_get_brightness.cfi_jt = . + 0x1b8f10;
	}
}
